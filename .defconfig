## .defconfig
```kconfig
CONFIG_CHIP_cv1842cp=y
CONFIG_DDR_CFG_ddr3_2133_x16=y
CONFIG_ARCH="arm"
CONFIG_CC_OPTIMIZE_FOR_SIZE=y
CONFIG_KERNEL_ENTRY_HACK=y
CONFIG_TOOLCHAIN_MUSL_ARM=y
CONFIG_FLASH_SIZE_SHRINK=y
CONFIG_BOOT_IMAGE_SINGLE_DTB=y
CONFIG_STORAGE_TYPE_spinor=y
CONFIG_PARTITION_COUNT=8
CONFIG_PARTITION_2_SIZE=1024
CONFIG_PARTITION_3_SIZE=3072
CONFIG_PARTITION_4_LABEL="MISC"
CONFIG_PARTITION_4_SIZE=128
CONFIG_PARTITION_4_FILE="logo.jpg"
CONFIG_PARTITION_6_LABEL="ENV_BAK"
CONFIG_PARTITION_6_SIZE=64
CONFIG_PARTITION_6_FILE=""
CONFIG_PARTITION_6_MOUNTPOINT=""
CONFIG_PARTITION_6_TYPE=""
CONFIG_PARTITION_7_LABEL="ROOTFS"
CONFIG_PARTITION_7_SIZE=4352
CONFIG_PARTITION_7_FILE="rootfs.spinor"
CONFIG_PARTITION_7_MOUNTPOINT=""
CONFIG_PARTITION_8_LABEL="DATA"
CONFIG_PARTITION_8_SIZE=1024
CONFIG_PARTITION_8_FILE="data.spinor"
CONFIG_PARTITION_8_MOUNTPOINT="/mnt/data"
CONFIG_PARTITION_8_TYPE="jffs2"
CONFIG_SENSOR_CVSENS_CV2003=y
CONFIG_SENSOR_GCORE_GC8613=y
CONFIG_SENSOR_OV_OS04A10=y
CONFIG_SENSOR_SMS_SC4336=y
CONFIG_SENSOR_SMS_SC4336P=y
CONFIG_SENSOR_SMS_SC4336P_SLAVE=y
CONFIG_SENSOR_SONY_IMX675=y
CONFIG_UBOOT_2021_10=y
CONFIG_KERNEL_SRC_5.10=y
CONFIG_KERNEL_LZMA=y
CONFIG_SKIP_RAMDISK=y
# CONFIG_ROOTFS_OVERLAYFS is not set
CONFIG_USE_4K_ERASE_SIZE_FOR_JFFS2=y
CONFIG_DUAL_OS=y
CONFIG_ENABLE_ALIOS=y
# CONFIG_RTOS_BUILD_IN_FIP is not set
# CONFIG_TARGET_PACKAGE_GDBSERVER is not set
# CONFIG_TARGET_PACKAGE_LIBCRYPTO is not set
# CONFIG_TARGET_PACKAGE_LIBZ is not set
# CONFIG_TARGET_PACKAGE_OTASERVER is not set
# CONFIG_TARGET_PACKAGE_RSYSLOG is not set
# CONFIG_TARGET_PACKAGE_CRONTABS is not set
# CONFIG_TARGET_PACKAGE_GATORD is not set
CONFIG_DRAM_SIZE=0x10000000
CONFIG_ALIOS_SIZE=0x500000
CONFIG_ALIOS_SYS_SIZE=0x400000
CONFIG_ALIOS_RESV_SIZE=0x800000
CONFIG_ION_SIZE=0xA00000
```
