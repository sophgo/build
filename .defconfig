## boards/cv184x/cv1842cp_wevb_0015a_sd/cv1842cp_wevb_0015a_sd_defconfig
```kconfig
CONFIG_CHIP_cv1842cp=y
CONFIG_BOARD_wevb_0015a_sd=y
CONFIG_DDR_CFG_ddr3_2133_x16=y
CONFIG_ARCH="arm"
CONFIG_CC_OPTIMIZE_FOR_SIZE=y
CONFIG_KERNEL_ENTRY_HACK=y
CONFIG_TOOLCHAIN_MUSL_ARM=y
CONFIG_FLASH_SIZE_SHRINK=y
CONFIG_BOOT_IMAGE_SINGLE_DTB=y
CONFIG_STORAGE_TYPE_sd=y
CONFIG_SENSOR_OV_OS04A10=y
CONFIG_SENSOR_SMS_SC235HAI=y
CONFIG_SENSOR_SMS_SC4336=y
CONFIG_SENSOR_SMS_SC4336P=y
CONFIG_SENSOR_SMS_SC4336P_SLAVE=y
CONFIG_SENSOR_CVSENS_CV2003=y
CONFIG_SENSOR_GCORE_GC2053=y
CONFIG_SENSOR_GCORE_GC2093=y
CONFIG_SENSOR_GCORE_GC4653=y
CONFIG_SENSOR_GCORE_GC8613=y
CONFIG_SENSOR_SONY_IMX307=y
CONFIG_SENSOR_SONY_IMX327=y
CONFIG_SENSOR_SONY_IMX675=y
CONFIG_UBOOT_2021_10=y
CONFIG_KERNEL_SRC_5.10=y
CONFIG_KERNEL_SRC="linux_5.10"
CONFIG_KERNEL_LZMA=y
CONFIG_SKIP_RAMDISK=y
CONFIG_SENSOR_TUNING_PARAM_cv184x_src_cvsens_cv2003=y
# CONFIG_ROOTFS_OVERLAYFS is not set
# CONFIG_TARGET_PACKAGE_RSYSLOG is not set
CONFIG_TARGET_PACKAGE_GDBSERVER=n
CONFIG_TARGET_PACKAGE_LIBCRYPTO=n
CONFIG_TARGET_PACKAGE_OTASERVER=n
CONFIG_TARGET_PACKAGE_CRONTABS=n
CONFIG_TARGET_PACKAGE_GATORD=n
CONFIG_SUSPEND=n
CONFIG_C906L_DMA_ENABLE=y
CONFIG_AUD_DRV_SEL=y
CONFIG_UBOOT_SPL_CUSTOM=n
```
