## boards/84x6/edge_84x6_wevb_emmc/u-boot/edge_84x6_wevb_emmc_defconfig
```kconfig
CONFIG_ARM=y
CONFIG_TARGET_CVITEK=y
#CONFIG_TARGET_CVITEK_CV186X=y
CONFIG_TARGET_CVITEK_CV84X6=y
CONFIG_SYS_MALLOC_F_LEN=0x2000
CONFIG_IDENT_STRING=" cvitek_sophgo"
CONFIG_ARMV8_SET_SMPEN=y
#CONFIG_TARGET_CVITEK_CV186X_WEVB_EMMC=y
CONFIG_TARGET_CVITEK_CV84X6_WEVB_EMMC=y
CONFIG_DEFAULT_DEVICE_TREE="cv84x6_wevb_emmc"
CONFIG_DISTRO_DEFAULTS=y
CONFIG_FIT=y
# CONFIG_ARCH_FIXUP_FDT_MEMORY is not set
CONFIG_BOOTDELAY=0
# CONFIG_DISPLAY_CPUINFO is not set
# CONFIG_DISPLAY_BOARDINFO is not set
CONFIG_SYS_PROMPT="sophon# "
# CONFIG_ISO_PARTITION is not set
CONFIG_EFI_PARTITION=y
CONFIG_OF_CONTROL=y
CONFIG_PHYLIB=y
# CONFIG_PHY_BROADCOM is not set
# CONFIG_PHY_SMSC is not set
CONFIG_PHY_FIXED=y
CONFIG_DWC_ETH_QOS=y
CONFIG_DM_ETH=y
CONFIG_NETDEVICES=y
CONFIG_ETH_DESIGNWARE=y
CONFIG_NET_RANDOM_ETHADDR=y
CONFIG_DM=y
CONFIG_DM_MMC=y
CONFIG_MMC=y
CONFIG_MMC_SDHCI=y
CONFIG_MMC_SDHCI_SDMA=y
CONFIG_MMC_SDHCI_CVITEK=y
CONFIG_MMC_HS400_SUPPORT=y
CONFIG_MMC_HS400_ES_SUPPORT=y
CONFIG_SUPPORT_EMMC_BOOT=y
CONFIG_SYS_NS16550=y
CONFIG_BAUDRATE=115200
CONFIG_LZ4=y
CONFIG_LZMA=y

CONFIG_CMD_MEMTEST=y
CONFIG_CMD_UNZIP=y
CONFIG_DM_GPIO=y
CONFIG_CMD_GPIO=y
CONFIG_DWAPB_GPIO=y
CONFIG_CMD_MMC=y
CONFIG_CMD_CACHE=y
CONFIG_CMD_FAT=y
CONFIG_CMD_CVI_UPDATE=y
CONFIG_CMD_CVI_SD_UPDATE=y
CONFIG_CMD_CVI_REBOOT=y
CONFIG_CMD_NFS=y
CONFIG_CMD_PART=y
CONFIG_OF_BOARD_SETUP=y
CONFIG_BOARD_LATE_INIT=y

#
# PCIe configurations
#
CONFIG_PCI=y
CONFIG_DM_PCI=y
CONFIG_PCIE_ECAM_GENERIC=y
CONFIG_CMD_PCI=y
CONFIG_CMD_DM=y

#
# SATA
#
CONFIG_AHCI=y
CONFIG_SCSI=y
CONFIG_DM_SCSI=y
CONFIG_DWC_AHCI_CV84X6=y
CONFIG_CMD_SCSI=y
CONFIG_CMD_SATA_BIST=y
CONFIG_CMD_SATA_OOB=y

CONFIG_ROOTFS_UBUNTU=y
# CONFIG_CMD_CONSOLE is not set
# CONFIG_CMD_IMLS is not set
# CONFIG_CMD_XIMG is not set
# CONFIG_CMD_EDITENV is not set
# CONFIG_CMD_ENV_EXISTS is not set
# CONFIG_CMD_LOADS is not set
# CONFIG_CMD_FPGA is not set
# CONFIG_CMD_ITEST is not set
# CONFIG_CMD_MISC is not set

#
# ENV
#
CONFIG_ENV_IS_IN_FAT=y
CONFIG_ENV_FAT_FILE="u-boot.env"
CONFIG_ENV_FAT_DEVICE_AND_PART="0:1"

CONFIG_MTD=y
CONFIG_SPI=y
# CONFIG_SPI_FLASH is not set

CONFIG_SYS_DCACHE_OFF=n
CONFIG_SYS_ICACHE_OFF=n
CONFIG_CC_OPTIMIZE_FOR_SIZE=n

CONFIG_USB=y
CONFIG_DM_USB=y
CONFIG_USB_HOST=y
CONFIG_CMD_USB=y
CONFIG_USB_DWC3=y
CONFIG_USB_XHCI_DWC3_OF_SIMPLE=y
CONFIG_USB_XHCI_HCD=y
CONFIG_USB_XHCI_DWC3=y
CONFIG_USB_STORAGE=y
```

## boards/88a2/edge_88a2_buildroot/rootfs/sglib/Config.in
```kconfig
config BR2_PACKAGE_SGLIB
    bool "Use sglib"
	default y
    help
        Use pre-downloaded sglib from local directory
```

## boards/cv181x/cv1812ca_wevb_0006a_spinor/cv1812ca_wevb_0006a_spinor_defconfig
```kconfig
CONFIG_CHIP_cv1812ca=y
CONFIG_BOARD_wevb_0006a_spinor=y
CONFIG_DDR_CFG_ddr3_1866_x16=y
CONFIG_ARCH="arm"
CONFIG_CC_OPTIMIZE_FOR_SIZE=y
CONFIG_KERNEL_ENTRY_HACK=y
CONFIG_KERNEL_ENTRY_HACK_ADDR="0x80108000"
CONFIG_TOOLCHAIN_GLIBC_ARM=y
CONFIG_FLASH_SIZE_SHRINK=y
CONFIG_BOOT_IMAGE_SINGLE_DTB=y
CONFIG_STORAGE_TYPE_spinor=y

CONFIG_UBOOT_2021_10=y
CONFIG_KERNEL_SRC_5.10=y
CONFIG_KERNEL_SRC="linux_5.10"
CONFIG_KERNEL_LZMA=y
CONFIG_SKIP_RAMDISK=y
CONFIG_USE_4K_ERASE_SIZE_FOR_JFFS2=y
# CONFIG_ROOTFS_OVERLAYFS is not set

CONFIG_ENABLE_ALIOS=y
CONFIG_COMPRESS_RTOS_BIN=y
CONFIG_C906L_DMA_ENABLE=n


CONFIG_OD_CLK_SEL=y

# uboot spl error
CONFIG_UBOOT_SPL_CUSTOM=y

CONFIG_VIRTUAL_UART=y
CONFIG_CV1811C_JD9165=y
CONFIG_ALIOS_CUSTOMIZATION_PIPELINE="cv1811c_jd9165"

CONFIG_TARGET_PACKAGE_GDBSERVER=n
CONFIG_TARGET_PACKAGE_LIBCRYPTO=n
CONFIG_TARGET_PACKAGE_LIBZ=n
CONFIG_TARGET_PACKAGE_OTASERVER=n
CONFIG_TARGET_PACKAGE_RSYSLOG=n
CONFIG_TARGET_PACKAGE_CRONTABS=n
CONFIG_TARGET_PACKAGE_GATORD=n
```

## boards/cv181x/cv1815ja_wevb_0020a_spinand/cv1815ja_wevb_0020a_spinand_defconfig
```kconfig
CONFIG_CHIP_cv1815ja=y
CONFIG_BOARD_wevb_0020a_spinand=y
CONFIG_DDR_CFG_ddr3_1866_x16=y
CONFIG_ARCH="arm"
CONFIG_CROSS_COMPILE_KERNEL="arm-linux-gnueabihf-"
CONFIG_CC_OPTIMIZE_FOR_SIZE=y
CONFIG_KERNEL_ENTRY_HACK=y
CONFIG_KERNEL_ENTRY_HACK_ADDR="0x80108000"
CONFIG_TOOLCHAIN_GLIBC_ARM=y
CONFIG_BUILD_FOR_DEBUG=y
CONFIG_FLASH_SIZE_SHRINK=y
CONFIG_BOOT_IMAGE_SINGLE_DTB=y
CONFIG_ATF_KEY_SEL_default=y
CONFIG_ATF_KEY_SEL="default"
CONFIG_FIP_V2=y
CONFIG_STORAGE_TYPE_spinand=y
CONFIG_NANDFLASH_BLOCKSIZE=131072
CONFIG_NANDFLASH_PAGESIZE=2048
CONFIG_SENSOR_GCORE_GC2053=y
CONFIG_SENSOR_GCORE_GC2053_1L=y
CONFIG_SENSOR_GCORE_GC2093=y
CONFIG_SENSOR_GCORE_GC4653=y
CONFIG_SENSOR_SMS_SC2336=y
CONFIG_SENSOR_SMS_SC3335=y
CONFIG_SENSOR_SMS_SC500AI=y
CONFIG_SENSOR_SONY_IMX307=y
CONFIG_SENSOR_SONY_IMX307_2L=y
CONFIG_SENSOR_SONY_IMX307_SLAVE=y
CONFIG_SENSOR_SONY_IMX327=y
CONFIG_SENSOR_SONY_IMX327_2L=y
CONFIG_SENSOR_SONY_IMX327_SLAVE=y
CONFIG_SENSOR_OV_OS04C10=y
CONFIG_SENSOR_OV_OS04A10=y
CONFIG_SENSOR_TUNING_PARAM_cv181x_src_gcore_gc4653=y
CONFIG_SENSOR_TUNING_PARAM="gcore_gc4653"
CONFIG_MIPI_PANEL_HX8394=y
CONFIG_PANEL_TUNING_PARAM="MIPI_panel_hx8394"
CONFIG_USE_DEFAULT_ENV=y
CONFIG_UBOOT_2021_10=y
CONFIG_UBOOT_SRC="u-boot-2021.10"
CONFIG_KERNEL_SRC_5.10=y
CONFIG_KERNEL_SRC="linux_5.10"
CONFIG_KERNEL_LZMA=y
CONFIG_KERNEL_COMPRESS="lzma"
CONFIG_SKIP_RAMDISK=y
CONFIG_ROOTFS_OVERLAYFS=y
CONFIG_ENABLE_FREERTOS=y
CONFIG_ENABLE_RTOS_DUMP_PRINT=y
CONFIG_DUMP_PRINT_SZ_IDX=17
CONFIG_TARGET_PACKAGE_DROPBEAR=y
CONFIG_TARGET_PACKAGE_LIBCRYPTO=y
CONFIG_TARGET_PACKAGE_OPENSSL=y
CONFIG_TARGET_PACKAGE_WIFI=y
# CONFIG_TARGET_PACKAGE_BUSYBOX_SYSLOGD_SCRIPT is not set
# CONFIG_TARGET_PACKAGE_MT7603U is not set
# CONFIG_TARGET_PACKAGE_LIBTIRPC is not set
# CONFIG_TARGET_PACKAGE_LIBNFS is not set
# CONFIG_TARGET_PACKAGE_BASH is not set
# CONFIG_TARGET_PACKAGE_CRONTABS is not set
# CONFIG_TARGET_PACKAGE_IPERF3 is not set
# CONFIG_TARGET_PACKAGE_E2FSPROGS is not set
# CONFIG_TARGET_PACKAGE_GATORD is not set
# CONFIG_TARGET_PACKAGE_STRESS is not set
# CONFIG_TARGET_PACKAGE_HTOP is not set
# end of Rootfs packages
CONFIG_TARGET_PACKAGE_NTP=y
```

## boards/cv184x/cv1840cp_wevb_0015a_spinor/cv1840cp_wevb_0015a_spinor_defconfig
```kconfig
CONFIG_CHIP_cv1840cp=y
CONFIG_BOARD_wevb_0015a_spinor=y
CONFIG_DDR_CFG_ddr2_1333_x16=y
CONFIG_ARCH="arm"
CONFIG_CC_OPTIMIZE_FOR_SIZE=y
CONFIG_KERNEL_ENTRY_HACK=y
CONFIG_TOOLCHAIN_MUSL_ARM=y
CONFIG_FLASH_SIZE_SHRINK=y
CONFIG_BOOT_IMAGE_SINGLE_DTB=y
CONFIG_STORAGE_TYPE_spinor=y
CONFIG_SENSOR_OV_OS04A10=y
CONFIG_SENSOR_SMS_SC4336=y
CONFIG_SENSOR_SMS_SC4336P=y
CONFIG_SENSOR_SMS_SC4336P_SLAVE=y
CONFIG_SENSOR_CVSENS_CV2003=y
#CONFIG_SENSOR_GCORE_GC2053=y
#CONFIG_SENSOR_GCORE_GC2053_1L=y
#CONFIG_SENSOR_GCORE_GC2093=y
#CONFIG_SENSOR_GCORE_GC4653=y
CONFIG_SENSOR_GCORE_GC8613=y
#CONFIG_SENSOR_PIXELPLUS_PR2020=y
#CONFIG_SENSOR_SONY_IMX307=y
#CONFIG_SENSOR_SONY_IMX327=y
CONFIG_SENSOR_SONY_IMX675=y
CONFIG_UBOOT_2021_10=y
CONFIG_KERNEL_SRC_5.10=y
CONFIG_KERNEL_SRC="linux_5.10"
CONFIG_KERNEL_LZMA=y
CONFIG_SKIP_RAMDISK=y
CONFIG_USE_4K_ERASE_SIZE_FOR_JFFS2=y
CONFIG_SENSOR_TUNING_PARAM_cv184x_src_cvsens_cv2003=y
#CONFIG_TARGET_PACKAGE_DROPBEAR=y
#CONFIG_TARGET_PACKAGE_NTP=y
CONFIG_TARGET_PACKAGE_GDBSERVER=n
CONFIG_TARGET_PACKAGE_LIBCRYPTO=n
CONFIG_TARGET_PACKAGE_LIBZ=n
CONFIG_TARGET_PACKAGE_OTASERVER=n
CONFIG_TARGET_PACKAGE_CRONTABS=n
CONFIG_TARGET_PACKAGE_RSYSLOG=n
CONFIG_TARGET_PACKAGE_GATORD=n
CONFIG_C906L_DMA_ENABLE=y
CONFIG_AUD_DRV_SEL=y
CONFIG_SUSPEND=n

CONFIG_DUAL_OS=n
CONFIG_ENABLE_RTT=y
CONFIG_RTOS_COMPRESS_ORIG=y
CONFIG_RTOS_BUILD_IN_FIP=y
CONFIG_DRAM_SIZE=0x04000000
CONFIG_ION_SIZE=0xA00000
CONFIG_RTOS_ION_SIZE=0x1000000

#
# Partition Configuration
#
CONFIG_FLASH_SIZE="16MB"
CONFIG_PARTITION_COUNT=7
CONFIG_PARTITION_1=y
CONFIG_PARTITION_1_LABEL="fip"
CONFIG_PARTITION_1_SIZE="1024"
CONFIG_PARTITION_1_FILE="fip_spl.bin"
CONFIG_PARTITION_1_MOUNTPOINT=""
CONFIG_PARTITION_1_TYPE=""

CONFIG_PARTITION_2=y
CONFIG_PARTITION_2_LABEL="2nd"
CONFIG_PARTITION_2_SIZE="3072"
CONFIG_PARTITION_2_FILE="yoc.bin"
CONFIG_PARTITION_2_MOUNTPOINT=""
CONFIG_PARTITION_2_TYPE=""
CONFIG_PARTITION_3=y

CONFIG_PARTITION_3_LABEL="PQ"
CONFIG_PARTITION_3_SIZE="1024"
CONFIG_PARTITION_3_FILE="pq_data.spino"
CONFIG_PARTITION_3_MOUNTPOINT=""
CONFIG_PARTITION_3_TYPE=""

CONFIG_PARTITION_4=y
CONFIG_PARTITION_4_LABEL="BOOT"
CONFIG_PARTITION_4_SIZE="4096"
CONFIG_PARTITION_4_FILE="boot.spinor"
CONFIG_PARTITION_4_MOUNTPOINT=""
CONFIG_PARTITION_4_TYPE=""

CONFIG_PARTITION_5=y
CONFIG_PARTITION_5_LABEL="ENV"
CONFIG_PARTITION_5_SIZE="64"
CONFIG_PARTITION_5_FILE=""
CONFIG_PARTITION_5_MOUNTPOINT=""
CONFIG_PARTITION_5_TYPE=""

CONFIG_PARTITION_6=y
CONFIG_PARTITION_6_LABEL="ROOTFS"
CONFIG_PARTITION_6_SIZE="5376"
CONFIG_PARTITION_6_FILE="rootfs.spinor"
CONFIG_PARTITION_6_MOUNTPOINT=""
CONFIG_PARTITION_6_TYPE=""

CONFIG_PARTITION_7=y
CONFIG_PARTITION_7_LABEL="DATA"
CONFIG_PARTITION_7_SIZE="1024"
CONFIG_PARTITION_7_FILE="data.spinor"
CONFIG_PARTITION_7_MOUNTPOINT="/mnt/data"
CONFIG_PARTITION_7_TYPE="jffs2"
# end of Partition Configuration
```

## boards/cv184x/cv1841c_wevb_0015a_emmc/cv1841c_wevb_0015a_emmc_defconfig
```kconfig
CONFIG_CHIP_cv1841c=y
CONFIG_BOARD_wevb_0015a_emmc=y
CONFIG_DDR_CFG_ddr3_1866_x16=y
CONFIG_ARCH="arm"
CONFIG_CC_OPTIMIZE_FOR_SIZE=y
CONFIG_KERNEL_ENTRY_HACK=y
CONFIG_TOOLCHAIN_GLIBC_ARM=y
CONFIG_FLASH_SIZE_SHRINK=y
CONFIG_BOOT_IMAGE_SINGLE_DTB=y
CONFIG_STORAGE_TYPE_emmc=y
CONFIG_SENSOR_OV_OS04A10=y
CONFIG_SENSOR_SMS_SC4336=y
CONFIG_SENSOR_SMS_SC4336P=y
CONFIG_SENSOR_SMS_SC4336P_SLAVE=y
CONFIG_SENSOR_CVSENS_CV2003=y
#CONFIG_SENSOR_GCORE_GC2053=y
#CONFIG_SENSOR_GCORE_GC2053_1L=y
#CONFIG_SENSOR_GCORE_GC2093=y
#CONFIG_SENSOR_GCORE_GC4653=y
CONFIG_SENSOR_GCORE_GC8613=y
#CONFIG_SENSOR_PIXELPLUS_PR2020=y
#CONFIG_SENSOR_SONY_IMX307=y
#CONFIG_SENSOR_SONY_IMX327=y
CONFIG_SENSOR_SONY_IMX675=y
CONFIG_UBOOT_2021_10=y
CONFIG_KERNEL_SRC_5.10=y
CONFIG_KERNEL_SRC="linux_5.10"
CONFIG_KERNEL_LZMA=y
CONFIG_SKIP_RAMDISK=y
CONFIG_SENSOR_TUNING_PARAM_cv184x_src_cvsens_cv2003=y
# CONFIG_ROOTFS_OVERLAYFS is not set
#CONFIG_TARGET_PACKAGE_DROPBEAR=y
# CONFIG_TARGET_PACKAGE_RSYSLOG is not set
#CONFIG_TARGET_PACKAGE_BUSYBOX_SYSLOGD_SCRIPT=y
CONFIG_TARGET_PACKAGE_GDBSERVER=n
CONFIG_TARGET_PACKAGE_LIBCRYPTO=n
CONFIG_TARGET_PACKAGE_LIBZ=n
CONFIG_TARGET_PACKAGE_OTASERVER=n
CONFIG_TARGET_PACKAGE_CRONTABS=n
CONFIG_TARGET_PACKAGE_GATORD=n

CONFIG_DUAL_OS=y
CONFIG_ENABLE_ALIOS=y
CONFIG_RTOS_BUILD_IN_FIP=n
CONFIG_DRAM_SIZE=0x08000000
CONFIG_ION_SIZE=0xA00000
CONFIG_ALIOS_SIZE=0x500000
CONFIG_ALIOS_SYS_SIZE=0x400000
CONFIG_ALIOS_RESV_SIZE=0x800000

#
# Partition Configuration
#
CONFIG_PARTITION_COUNT=9
# eMMC use partation 1 to store fip.bin so we started form partition 2
CONFIG_PARTITION_2=y
CONFIG_PARTITION_2_LABEL="2nd"
CONFIG_PARTITION_2_SIZE=3072
CONFIG_PARTITION_2_FILE="yoc.bin"
CONFIG_PARTITION_2_MOUNTPOINT=""
CONFIG_PARTITION_2_TYPE=""

CONFIG_PARTITION_3=y
CONFIG_PARTITION_3_LABEL="BOOT"
CONFIG_PARTITION_3_SIZE=8192
CONFIG_PARTITION_3_FILE="boot.emmc"
CONFIG_PARTITION_3_MOUNTPOINT=""
CONFIG_PARTITION_3_TYPE=""

CONFIG_PARTITION_4=y
CONFIG_PARTITION_4_LABEL="MISC"
CONFIG_PARTITION_4_SIZE=512
CONFIG_PARTITION_4_FILE="logo.jpg"
CONFIG_PARTITION_4_MOUNTPOINT=""
CONFIG_PARTITION_4_TYPE=""

CONFIG_PARTITION_5=y
CONFIG_PARTITION_5_LABEL="ENV"
CONFIG_PARTITION_5_SIZE=128
CONFIG_PARTITION_5_FILE=""
CONFIG_PARTITION_5_MOUNTPOINT=""
CONFIG_PARTITION_5_TYPE=""

CONFIG_PARTITION_6=y
CONFIG_PARTITION_6_LABEL="ROOTFS"
CONFIG_PARTITION_6_SIZE=70656
CONFIG_PARTITION_6_FILE="rootfs.emmc"
CONFIG_PARTITION_6_MOUNTPOINT=""
CONFIG_PARTITION_6_TYPE=""

CONFIG_PARTITION_7=y
CONFIG_PARTITION_7_LABEL="SYSTEM"
CONFIG_PARTITION_7_SIZE=40960
CONFIG_PARTITION_7_FILE="system.emmc"
CONFIG_PARTITION_7_MOUNTPOINT="/mnt/system"
CONFIG_PARTITION_7_TYPE="ext4"

CONFIG_PARTITION_8=y
CONFIG_PARTITION_8_LABEL="CFG"
CONFIG_PARTITION_8_SIZE=15240
CONFIG_PARTITION_8_FILE="cfg.emmc"
CONFIG_PARTITION_8_MOUNTPOINT="mnt/cfg"
CONFIG_PARTITION_8_TYPE="ext4"

CONFIG_PARTITION_9=y
CONFIG_PARTITION_9_LABEL="DATA"
CONFIG_PARTITION_9_SIZE=3145728
CONFIG_PARTITION_9_FILE="data.emmc"
CONFIG_PARTITION_9_MOUNTPOINT="mnt/data"
CONFIG_PARTITION_9_TYPE="ext4"
# end of Partition Configuration
```

## boards/cv184x/cv1841c_wevb_0015a_spinor/cv1841c_wevb_0015a_spinor_defconfig
```kconfig
CONFIG_CHIP_cv1841c=y
CONFIG_BOARD_wevb_0015a_spinor=y
CONFIG_DDR_CFG_ddr3_1866_x16=y
CONFIG_ARCH="arm"
CONFIG_CC_OPTIMIZE_FOR_SIZE=y
CONFIG_KERNEL_ENTRY_HACK=y
CONFIG_TOOLCHAIN_MUSL_ARM=y
CONFIG_FLASH_SIZE_SHRINK=y
CONFIG_BOOT_IMAGE_SINGLE_DTB=y
CONFIG_STORAGE_TYPE_spinor=y
CONFIG_SENSOR_OV_OS04A10=y
CONFIG_SENSOR_SMS_SC4336=y
CONFIG_SENSOR_SMS_SC4336P=y
CONFIG_SENSOR_SMS_SC4336P_SLAVE=y
CONFIG_SENSOR_CVSENS_CV2003=y
#CONFIG_SENSOR_GCORE_GC2053=y
#CONFIG_SENSOR_GCORE_GC2053_1L=y
#CONFIG_SENSOR_GCORE_GC2093=y
#CONFIG_SENSOR_GCORE_GC4653=y
CONFIG_SENSOR_GCORE_GC8613=y
#CONFIG_SENSOR_PIXELPLUS_PR2020=y
#CONFIG_SENSOR_SONY_IMX307=y
#CONFIG_SENSOR_SONY_IMX327=y
CONFIG_SENSOR_SONY_IMX675=y
CONFIG_UBOOT_2021_10=y
CONFIG_KERNEL_SRC_5.10=y
CONFIG_KERNEL_SRC="linux_5.10"
CONFIG_KERNEL_LZMA=y
CONFIG_SKIP_RAMDISK=y
CONFIG_USE_4K_ERASE_SIZE_FOR_JFFS2=y
CONFIG_SENSOR_TUNING_PARAM_cv184x_src_cvsens_cv2003=y
#CONFIG_TARGET_PACKAGE_DROPBEAR=y
#CONFIG_TARGET_PACKAGE_NTP=y
CONFIG_TARGET_PACKAGE_GDBSERVER=n
CONFIG_TARGET_PACKAGE_LIBCRYPTO=n
CONFIG_TARGET_PACKAGE_LIBZ=n
CONFIG_TARGET_PACKAGE_OTASERVER=n
CONFIG_TARGET_PACKAGE_CRONTABS=n
CONFIG_TARGET_PACKAGE_RSYSLOG=n
CONFIG_TARGET_PACKAGE_GATORD=n
CONFIG_C096L_DMA_ENABLE=y
CONFIG_AUD_DRV_SEL=y
CONFIG_SUSPEND=n

CONFIG_DUAL_OS=y
CONFIG_ENABLE_ALIOS=y
CONFIG_RTOS_BUILD_IN_FIP=n
CONFIG_DRAM_SIZE=0x08000000
CONFIG_ION_SIZE=0xA00000
CONFIG_ALIOS_SIZE=0x500000
CONFIG_ALIOS_SYS_SIZE=0x400000
CONFIG_ALIOS_RESV_SIZE=0x800000

#
# Partition Configuration
#
CONFIG_PARTITION_COUNT=7
CONFIG_PARTITION_1=y
CONFIG_PARTITION_1_LABEL="fip"
CONFIG_PARTITION_1_SIZE=1024
CONFIG_PARTITION_1_FILE="fip_spl.bin"
CONFIG_PARTITION_1_MOUNTPOINT=""
CONFIG_PARTITION_1_TYPE=""

CONFIG_PARTITION_2=y
CONFIG_PARTITION_2_LABEL="2nd"
CONFIG_PARTITION_2_SIZE=3072
CONFIG_PARTITION_2_FILE="yoc.bin"
CONFIG_PARTITION_2_MOUNTPOINT=""
CONFIG_PARTITION_2_TYPE=""
CONFIG_PARTITION_3=y

CONFIG_PARTITION_3_LABEL="PQ"
CONFIG_PARTITION_3_SIZE=1024
CONFIG_PARTITION_3_FILE="pq_data.spino"
CONFIG_PARTITION_3_MOUNTPOINT=""
CONFIG_PARTITION_3_TYPE=""

CONFIG_PARTITION_4=y
CONFIG_PARTITION_4_LABEL="BOOT"
CONFIG_PARTITION_4_SIZE=5120
CONFIG_PARTITION_4_FILE="boot.spinor"
CONFIG_PARTITION_4_MOUNTPOINT=""
CONFIG_PARTITION_4_TYPE=""

CONFIG_PARTITION_5=y
CONFIG_PARTITION_5_LABEL="ENV"
CONFIG_PARTITION_5_SIZE=64
CONFIG_PARTITION_5_FILE=""
CONFIG_PARTITION_5_MOUNTPOINT=""
CONFIG_PARTITION_5_TYPE=""

CONFIG_PARTITION_6=y
CONFIG_PARTITION_6_LABEL="ROOTFS"
CONFIG_PARTITION_6_SIZE=4288
CONFIG_PARTITION_6_FILE="rootfs.spinor"
CONFIG_PARTITION_6_MOUNTPOINT=""
CONFIG_PARTITION_6_TYPE=""

CONFIG_PARTITION_7=y
CONFIG_PARTITION_7_LABEL="DATA"
CONFIG_PARTITION_7_SIZE=1024
CONFIG_PARTITION_7_FILE="data.spinor"
CONFIG_PARTITION_7_MOUNTPOINT="/mnt/data"
CONFIG_PARTITION_7_TYPE="jffs2"
# end of Partition Configuration
```
