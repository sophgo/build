## boards/84x6/device_84x6_wevb_emmc/device_84x6_wevb_emmc_defconfig
```kconfig
CONFIG_CHIP_cv84x6=y
CONFIG_SIDE_TYPE_device=y
CONFIG_ARCH="arm64"
CONFIG_BOARD_wevb_emmc=y
CONFIG_DDR_CFG_lp5x_2r_8533=y
CONFIG_CHIP_ARCH_84x6=y
CONFIG_STORAGE_TYPE_emmc=y

CONFIG_KERNEL_ENTRY_HACK=n
CONFIG_CC_OPTIMIZE_FOR_SIZE=y
CONFIG_FLASH_SIZE_SHRINK=y
CONFIG_BOOT_IMAGE_SINGLE_DTB=y
CONFIG_KERNEL_LZMA=y
CONFIG_SKIP_RAMDISK=y
CONFIG_USE_4K_ERASE_SIZE_FOR_JFFS2=y
CONFIG_TOOLCHAIN_GLIBC_ARM64=y
CONFIG_UBOOT_2021_10=y
CONFIG_KERNEL_SRC_5.10=y

#
# Sensor settings
#
CONFIG_SENSOR_GCORE_GC4653=y
CONFIG_SENSOR_GCORE_GC8613=y
CONFIG_SENSOR_SMS_SC3335=y
CONFIG_SENSOR_SMS_SC500AI=y
CONFIG_SENSOR_SONY_IMX307=y
CONFIG_SENSOR_SONY_IMX307_2L=y
CONFIG_SENSOR_SONY_IMX307_SLAVE=y
CONFIG_SENSOR_SONY_IMX327=y
CONFIG_SENSOR_SONY_IMX327_2L=y
CONFIG_SENSOR_SONY_IMX327_SLAVE=y
CONFIG_SENSOR_SONY_IMX412=y
CONFIG_SENSOR_SONY_IMX415=y
CONFIG_SENSOR_SONY_IMX585=y
CONFIG_SENSOR_SONY_IMX900=y
CONFIG_SENSOR_ONSEMI_AR2020=y
CONFIG_SENSOR_OV_OV2736=y
CONFIG_SENSOR_OV_OS04A10=y
CONFIG_SENSOR_OV_OS04C10=y
CONFIG_SENSOR_OV_OS04E10=y
CONFIG_SENSOR_OV_OS08B10=y
CONFIG_SENSOR_SMS_SC4336P=y
CONFIG_SENSOR_SMS_SC4336P_SLAVE=y
CONFIG_SENSOR_NUC_NC021=y
CONFIG_SENSOR_PIXELPLUS_PR2100=y
CONFIG_SENSOR_PIXELPLUS_PR2020=y
CONFIG_SENSOR_TUNING_PARAM_sophon_src_sony_imx585=y

#
# Panel settings
#

#
# Panel support list
#

CONFIG_TARGET_PACKAGE_DROPBEAR=y
CONFIG_TARGET_PACKAGE_MTD-UTILS=y
CONFIG_TARGET_PACKAGE_BUSYBOX_SYSLOGD_SCRIPT=y
# CONFIG_TARGET_PACKAGE_CVITRACER is not set
# CONFIG_TARGET_PACKAGE_GDBSERVER is not set
# CONFIG_TARGET_PACKAGE_LIBZ is not set
# CONFIG_TARGET_PACKAGE_OTASERVER is not set
# CONFIG_TARGET_PACKAGE_RSYSLOG is not set
# CONFIG_TARGET_PACKAGE_CRONTABS is not set
# CONFIG_TARGET_PACKAGE_GATORD is not set

CONFIG_TARGET_PACKAGE_WIFI=y
CONFIG_CP_EXT_WIRELESS=y
CONFIG_TARGET_PACKAGE_BT=y
CONFIG_TARGET_PACKAGE_OPENSSL=y
CONFIG_TARGET_PACKAGE_LIBCRYPTO=y
CONFIG_TARGET_PACKAGE_PARTED=y
CONFIG_TARGET_PACKAGE_NTP=y
CONFIG_TOOLCHAIN_GLIBC_ARM64_V1131=y

#
# PCIe settings
#
CONFIG_FSBL_IGNORE_PCIE_TRAP=y
CONFIG_FSBL_PCIE_SSMODE=2
CONFIG_FSBL_PCIE_CTRL0_RC=y
CONFIG_FSBL_PCIE_CTRL1_RC=y
CONFIG_FSBL_PCIE_CTRL2_RC=y
CONFIG_FSBL_PCIE_CTRL3_RC=y
```

## boards/84x6/device_84x6_wevb_emmc/multi.its
```
/*
 * U-Boot uImage source file with multiple FDT blobs
 * for CV84X6 device_84x6_wevb_emmc
 */

/dts-v1/;

/ {
	description = "Various kernels, ramdisks and FDT blobs";
	#address-cells = <2>;

	images {
		kernel-1 {
			description = "cvitek kernel";
			data = /incbin/("./Image");
			type = "kernel";
			arch = "arm64";
			os = "linux";
			compression = "none";
			load = <0x10 0x02000000>;
			entry = <0x10 0x02000000>;
			hash-2 {
				algo = "sha256";
			};
		};

		ramdisk-1 {
			description = "cvitek ramdisk";
			data = /incbin/("./boot.cpio.gz");
			type = "ramdisk";
			arch = "arm64";
			os = "linux";
			compression = "gzip";
			load = <00000000>;
			entry = <00000000>;
			hash-1 {
				algo = "crc32";
			};
		};

		/*FDT*/
		fdt-cv84x6_wevb_emmc {
			description = "cvitek device tree - cv84x6_wevb_emmc";
			data = /incbin/("./cv84x6_wevb_emmc.dtb");
			type = "flat_dt";
			arch = "arm64";
			compression = "none";
			hash-1 {
				algo = "sha256";
			};
		};

		fdt-cv84x6_wevb_emmc_8G {
			description = "cvitek device tree - cv84x6_wevb_emmc_8G";
			data = /incbin/("./cv84x6_wevb_emmc_8G.dtb");
			type = "flat_dt";
			arch = "arm64";
			compression = "none";
			hash-1 {
				algo = "sha256";
			};
		};

		fdt-cv84x6_wevb_emmc_16G {
			description = "cvitek device tree - cv84x6_wevb_emmc_16G";
			data = /incbin/("./cv84x6_wevb_emmc_16G.dtb");
			type = "flat_dt";
			arch = "arm64";
			compression = "none";
			hash-1 {
				algo = "sha256";
			};
		};

		fdt-cv84x6_wevb_emmc_32G {
			description = "cvitek device tree - cv84x6_wevb_emmc_32G";
			data = /incbin/("./cv84x6_wevb_emmc_32G.dtb");
			type = "flat_dt";
			arch = "arm64";
			compression = "none";
			hash-1 {
				algo = "sha256";
			};
		};
	};

	configurations {
		default = "config-cv84x6_wevb_emmc";

		config-cv84x6_wevb_emmc {
			description = "boot cvitek system with board cv84x6_wevb_emmc";
			kernel = "kernel-1";
			fdt = "fdt-cv84x6_wevb_emmc";
		};

		config-cv84x6_wevb_emmc_8G {
			description = "boot cvitek system with board cv84x6_wevb_emmc_8G";
			kernel = "kernel-1";
			fdt = "fdt-cv84x6_wevb_emmc_8G";
		};

		config-cv84x6_wevb_emmc_16G {
			description = "boot cvitek system with board cv84x6_wevb_emmc_16G";
			kernel = "kernel-1";
			fdt = "fdt-cv84x6_wevb_emmc_16G";
		};

		config-cv84x6_wevb_emmc_32G {
			description = "boot cvitek system with board cv84x6_wevb_emmc_32G";
			kernel = "kernel-1";
			fdt = "fdt-cv84x6_wevb_emmc_32G";
		};
	};
};
```

## boards/84x6/device_84x6_wevb_emmc/u-boot/device_84x6_wevb_emmc_defconfig
```kconfig
CONFIG_ARM=y
CONFIG_TARGET_CVITEK=y
CONFIG_TARGET_CVITEK_CV84X6=y
CONFIG_SYS_MALLOC_F_LEN=0x2000
CONFIG_IDENT_STRING=" cvitek_sophgo"
CONFIG_ARMV8_SET_SMPEN=y
CONFIG_TARGET_CVITEK_CV84X6_WEVB_EMMC=y
CONFIG_DEFAULT_DEVICE_TREE="cv84x6_wevb_emmc"
CONFIG_DISTRO_DEFAULTS=y
CONFIG_FIT=y
# CONFIG_ARCH_FIXUP_FDT_MEMORY is not set
CONFIG_BOARD_LATE_INIT=y
CONFIG_BOOTDELAY=1
# CONFIG_DISPLAY_CPUINFO is not set
# CONFIG_DISPLAY_BOARDINFO is not set
CONFIG_SYS_PROMPT="sophon# "
# CONFIG_ISO_PARTITION is not set
# CONFIG_EFI_PARTITION is not set
CONFIG_OF_CONTROL=y
CONFIG_PHYLIB=y
# CONFIG_PHY_BROADCOM is not set
# CONFIG_PHY_SMSC is not set
CONFIG_PHY_FIXED=y
CONFIG_DWC_ETH_QOS=y
CONFIG_DM_ETH=y
CONFIG_NETDEVICES=y
CONFIG_ETH_DESIGNWARE=y
CONFIG_NET_RANDOM_ETHADDR=y
CONFIG_DM=y
CONFIG_DM_MMC=y
CONFIG_MMC=y
CONFIG_MMC_SDHCI=y
CONFIG_MMC_SDHCI_SDMA=y
CONFIG_MMC_SDHCI_CVITEK=y
CONFIG_MMC_HS400_SUPPORT=y
CONFIG_MMC_HS400_ES_SUPPORT=y
CONFIG_SUPPORT_EMMC_BOOT=y
CONFIG_SYS_NS16550=y
CONFIG_BAUDRATE=115200
CONFIG_LZ4=y
CONFIG_LZMA=y

CONFIG_CMD_MEMTEST=y
CONFIG_CMD_UNZIP=y
CONFIG_CMD_MMC=y
CONFIG_CMD_CACHE=y
CONFIG_CMD_FAT=y
CONFIG_CMD_CVI_UPDATE=y
CONFIG_CMD_CVI_SD_UPDATE=y
CONFIG_CMD_CVI_REBOOT=y
CONFIG_CMD_NFS=y
CONFIG_CMD_PART=y
# CONFIG_CMD_CONSOLE is not set
# CONFIG_CMD_IMLS is not set
# CONFIG_CMD_XIMG is not set
# CONFIG_CMD_EDITENV is not set
# CONFIG_CMD_ENV_EXISTS is not set
# CONFIG_CMD_LOADS is not set
# CONFIG_CMD_FPGA is not set
# CONFIG_CMD_ITEST is not set
# CONFIG_CMD_MISC is not set
CONFIG_ENV_IS_IN_MMC=y
CONFIG_MTD=y
CONFIG_SPI=y
# CONFIG_SPI_FLASH is not set

CONFIG_CMD_GPIO=y
CONFIG_DWAPB_GPIO=y
CONFIG_DM_GPIO=y

CONFIG_CMD_I2C=y
CONFIG_DM_I2C=y
CONFIG_SYS_I2C_DW=y

CONFIG_ADC=y
CONFIG_ADC_CVITEK=y
CONFIG_CMD_ADC=y

CONFIG_DM_PWM=y
CONFIG_CMD_PWM=y
CONFIG_PWM_CVITEK=y

CONFIG_WATCHDOG=y
CONFIG_WATCHDOG_AUTOSTART=y
CONFIG_WATCHDOG_TIMEOUT_MSECS=60000
CONFIG_DESIGNWARE_WATCHDOG=y
CONFIG_WDT=y

CONFIG_USB=y
CONFIG_DM_USB=y
CONFIG_USB_HOST=y
CONFIG_CMD_USB=y
CONFIG_USB_DWC3=y
CONFIG_USB_XHCI_DWC3_OF_SIMPLE=y
CONFIG_USB_XHCI_HCD=y
CONFIG_USB_XHCI_DWC3=y
CONFIG_USB_STORAGE=y
CONFIG_CMD_FAT=y
CONFIG_PARTITIONS=y
CONFIG_EFI_PARTITION=y
CONFIG_CMD_GPT=y

#
# PCIe configurations
#
CONFIG_PCI=y
CONFIG_DM_PCI=y
CONFIG_PCIE_ECAM_GENERIC=y
CONFIG_CMD_PCI=y
CONFIG_CMD_DM=y
CONFIG_OF_BOARD_SETUP=y

CONFIG_FIT_SIGNATURE=n
CONFIG_FIT_RSASSA_PSS=n
CONFIG_FIT_CIPHER=n
CONFIG_AES=y
CONFIG_TOOLS_LIBCRYPTO=y

CONFIG_SYS_DCACHE_OFF=n
CONFIG_SYS_ICACHE_OFF=n
CONFIG_CC_OPTIMIZE_FOR_SIZE=n
```

## boards/84x6/edge_84x6_palladium/edge_84x6_palladium_defconfig
```kconfig
CONFIG_CHIP_cv84x6=y
CONFIG_SIDE_TYPE_edge=y
CONFIG_ARCH="arm64"
CONFIG_BOARD_palladium=y
CONFIG_DDR_CFG_lp5x_2r_8533=y
CONFIG_CHIP_ARCH_84x6=y
CONFIG_STORAGE_TYPE_none=y

CONFIG_KERNEL_ENTRY_HACK=n
CONFIG_CC_OPTIMIZE_FOR_SIZE=y
CONFIG_FLASH_SIZE_SHRINK=y
CONFIG_BOOT_IMAGE_SINGLE_DTB=y
#CONFIG_ROOTFS_OVERLAYFS=y
# CONFIG_TARGET_PACKAGE_GDBSERVER is not set
# CONFIG_TARGET_PACKAGE_NANOMSG is not set
# CONFIG_TARGET_PACKAGE_OTASERVER is not set
# CONFIG_TARGET_PACKAGE_RSYSLOG is not set
CONFIG_TOOLCHAIN_GLIBC_ARM64=y
CONFIG_UBOOT_2021_10=y
CONFIG_KERNEL_SRC_5.10=y
CONFIG_KERNEL_UNCOMPRESSED=y
CONFIG_KERNEL_COMPRESS="none"
CONFIG_ROOTFS_UBUNTU=y
#CONFIG_KERNEL_LZMA is not set
CONFIG_SKIP_RAMDISK=y
CONFIG_USE_4K_ERASE_SIZE_FOR_JFFS2=y
CONFIG_TARGET_PACKAGE_DROPBEAR=y
CONFIG_TARGET_PACKAGE_MTD-UTILS=y
CONFIG_TARGET_PACKAGE_BUSYBOX_SYSLOGD_SCRIPT=y
#
# Sensor settings
#

#
# Sensor support list
#
CONFIG_SENSOR_SONY_IMX327_FPGA=y

#
# Panel settings
#

#
# Panel support list
#
CONFIG_TOOLCHAIN_GLIBC_ARM64_V1131=y
```

## boards/84x6/edge_84x6_wevb_emmc/edge_84x6_wevb_emmc_defconfig
```kconfig
CONFIG_CHIP_cv84x6=y
CONFIG_SIDE_TYPE_edge=y
CONFIG_ARCH="arm64"
CONFIG_BOARD_wevb_emmc=y
CONFIG_KERNEL_BOOT_TYPE_emmc=y
CONFIG_DDR_CFG_lp5x_2r_8533=y
CONFIG_CHIP_ARCH_84x6=y
CONFIG_STORAGE_TYPE_emmc=y

CONFIG_KERNEL_ENTRY_HACK=n
CONFIG_CC_OPTIMIZE_FOR_SIZE=y
CONFIG_FLASH_SIZE_SHRINK=y
# CONFIG_BOOT_IMAGE_SINGLE_DTB=y
#CONFIG_ROOTFS_OVERLAYFS=y
# CONFIG_TARGET_PACKAGE_GDBSERVER is not set
# CONFIG_TARGET_PACKAGE_NANOMSG is not set
# CONFIG_TARGET_PACKAGE_OTASERVER is not set
# CONFIG_TARGET_PACKAGE_RSYSLOG is not set
CONFIG_TOOLCHAIN_GLIBC_ARM64=y
CONFIG_UBOOT_2021_10=y
CONFIG_KERNEL_SRC_5.10=y
CONFIG_KERNEL_UNCOMPRESSED=y
CONFIG_KERNEL_COMPRESS="none"
CONFIG_ROOTFS_UBUNTU=y
#CONFIG_KERNEL_LZMA is not set
CONFIG_SKIP_RAMDISK=n
CONFIG_USE_4K_ERASE_SIZE_FOR_JFFS2=y
CONFIG_TARGET_PACKAGE_DROPBEAR=y
CONFIG_TARGET_PACKAGE_MTD-UTILS=y
CONFIG_TARGET_PACKAGE_BUSYBOX_SYSLOGD_SCRIPT=y
#
# Sensor settings
#

#
# Sensor support list
#
CONFIG_SENSOR_SONY_IMX327_FPGA=y

#
# Panel settings
#

#
# Panel support list
#
CONFIG_TOOLCHAIN_GLIBC_ARM64_V1131=y

#
# PCIe settings
#
CONFIG_FSBL_IGNORE_PCIE_TRAP=y
CONFIG_FSBL_PCIE_SSMODE=3
CONFIG_FSBL_PCIE_CTRL0_RC=y
```

## boards/84x6/edge_84x6_wevb_emmc/multi.its
```
/*
 * U-Boot uImage source file with multiple kernels, ramdisks and FDT blobs
 * for CV84X6
 */

/dts-v1/;

/ {
	description = "Various kernels, ramdisks and FDT blobs";
	#address-cells = <2>;

	images {
		kernel-1 {
			description = "cvitek kernel";
			data = /incbin/("./Image");
			type = "kernel";
			arch = "arm64";
			os = "linux";
			compression = "none";
			load = <0x10 0x02000000>;
			entry = <0x10 0x02000000>;
			hash-2 {
				algo = "sha256";
			};
		};

		ramdisk-1 {
			description = "cvitek ramdisk";
			data = /incbin/("./boot.cpio.gz");
			type = "ramdisk";
			arch = "arm64";
			os = "linux";
			compression = "gzip";
			load = <00000000>;
			entry = <00000000>;
			hash-1 {
				algo = "crc32";
			};
		};

		/*FDT*/
		fdt-cv84x6_wevb_emmc {
			description = "cvitek device tree - cv84x6_wevb_emmc";
			data = /incbin/("./cv84x6_wevb_emmc.dtb");
			type = "flat_dt";
			arch = "arm64";
			compression = "none";
			hash-1 {
				algo = "sha256";
			};
		};

		fdt-cv84x6_se13v1_8G {
			description = "cvitek device tree - cv84x6_se13v1_8G";
			data = /incbin/("./cv84x6_se13v1_8G.dtb");
			type = "flat_dt";
			arch = "arm64";
			compression = "none";
			hash-1 {
				algo = "sha256";
			};
		};

		fdt-cv84x6_se13v1_16G {
			description = "cvitek device tree - cv84x6_se13v1_16G";
			data = /incbin/("./cv84x6_se13v1_16G.dtb");
			type = "flat_dt";
			arch = "arm64";
			compression = "none";
			hash-1 {
				algo = "sha256";
			};
		};

		fdt-cv84x6_se13v1_24G {
			description = "cvitek device tree - cv84x6_se13v1_24G";
			data = /incbin/("./cv84x6_se13v1_24G.dtb");
			type = "flat_dt";
			arch = "arm64";
			compression = "none";
			hash-1 {
				algo = "sha256";
			};
		};

		fdt-cv84x6_se13v1_32G {
			description = "cvitek device tree - cv84x6_se13v1_32G";
			data = /incbin/("./cv84x6_se13v1_32G.dtb");
			type = "flat_dt";
			arch = "arm64";
			compression = "none";
			hash-1 {
				algo = "sha256";
			};
		};

		fdt-cv84x6_sm13v1_16G {
			description = "cvitek device tree - cv84x6_sm13v1_16G";
			data = /incbin/("./cv84x6_sm13v1_16G.dtb");
			type = "flat_dt";
			arch = "arm64";
			compression = "none";
			hash-1 {
				algo = "sha256";
			};
		};

		fdt-cv84x6_sm13v1_24G {
			description = "cvitek device tree - cv84x6_sm13v1_24G";
			data = /incbin/("./cv84x6_sm13v1_24G.dtb");
			type = "flat_dt";
			arch = "arm64";
			compression = "none";
			hash-1 {
				algo = "sha256";
			};
		};

		fdt-cv84x6_sm13v1_32G {
			description = "cvitek device tree - cv84x6_sm13v1_32G";
			data = /incbin/("./cv84x6_sm13v1_32G.dtb");
			type = "flat_dt";
			arch = "arm64";
			compression = "none";
			hash-1 {
				algo = "sha256";
			};
		};
	};

	configurations {
		default = "config-cv84x6_wevb_emmc";

		/*CFG*/
		config-cv84x6_wevb_emmc {
			description = "boot cvitek system with board cv84x6_wevb_emmc";
			kernel = "kernel-1";
			ramdisk = "ramdisk-1";
			fdt = "fdt-cv84x6_wevb_emmc";
		};

		config-cv84x6_se13v1_8G {
			description = "boot cvitek system with board cv84x6_se13v1_8G";
			kernel = "kernel-1";
			ramdisk = "ramdisk-1";
			fdt = "fdt-cv84x6_se13v1_8G";
		};

		config-cv84x6_se13v1_16G {
			description = "boot cvitek system with board cv84x6_se13v1_16G";
			kernel = "kernel-1";
			ramdisk = "ramdisk-1";
			fdt = "fdt-cv84x6_se13v1_16G";
		};

		config-cv84x6_se13v1_24G {
			description = "boot cvitek system with board cv84x6_se13v1_24G";
			kernel = "kernel-1";
			ramdisk = "ramdisk-1";
			fdt = "fdt-cv84x6_se13v1_24G";
		};

		config-cv84x6_se13v1_32G {
			description = "boot cvitek system with board cv84x6_se13v1_32G";
			kernel = "kernel-1";
			ramdisk = "ramdisk-1";
			fdt = "fdt-cv84x6_se13v1_32G";
		};

		config-cv84x6_sm13v1_16G {
			description = "boot cvitek system with board cv84x6_sm13v1_16G";
			kernel = "kernel-1";
			ramdisk = "ramdisk-1";
			fdt = "fdt-cv84x6_sm13v1_16G";
		};

		config-cv84x6_sm13v1_24G {
			description = "boot cvitek system with board cv84x6_sm13v1_24G";
			kernel = "kernel-1";
			ramdisk = "ramdisk-1";
			fdt = "fdt-cv84x6_sm13v1_24G";
		};

		config-cv84x6_sm13v1_32G {
			description = "boot cvitek system with board cv84x6_sm13v1_32G";
			kernel = "kernel-1";
			ramdisk = "ramdisk-1";
			fdt = "fdt-cv84x6_sm13v1_32G";
		};
	};
};
```
