## boards/sophon/device_fastboot/multi.its
```
/*
 * U-Boot uImage source file with multiple kernels, ramdisks and FDT blobs
 */

/dts-v1/;

/ {
	description = "Various kernels, FDT blobs";
#address-cells = <2>;

	images {
		kernel-1 {
			description = "cvitek kernel";
			data = /incbin/("./Image.lzma");
			type = "kernel";
			arch = "arm64";
			os = "linux";
			compression = "lzma";
			load = <0x1 0x00200000>;
			entry = <0x1 0x00200000>;
			hash-1 {
				algo = "sha256";
			};
			signature {
				algo = "sha256,rsa2048";
				padding = "pss";
				key-name-hint = "cfg";
			};
		};

		/*ramdisk-1 {
			description = "cvitek ramdisk";
			data = /incbin/("./boot.cpio.gz");
			type = "ramdisk";
			arch = "arm64";
			os = "linux";
			compression = "gzip";
			load = <00000000>;
			entry = <00000000>;
			hash-1 {
				algo = "sha256";
			};
			signature {
				algo = "sha256,rsa2048";
				padding = "pss";
				key-name-hint = "cfg";
			};
		};*/

		/*FDT*/

		fdt-cv186ah_wevb_emmc {
			description = "cvitek device tree - cv186ah_wevb_emmc";
			data = /incbin/("./cv186ah_wevb_emmc.dtb");
			type = "flat_dt";
			arch = "arm64";
			compression = "none";
			hash-1 {
				algo = "sha256";
			};
			signature {
				algo = "sha256,rsa2048";
				padding = "pss";
				key-name-hint = "cfg";
			};
		};

		fdt-cv186ah_wevb_emmc_4G {
			description = "cvitek device tree - cv186ah_wevb_4G";
			data = /incbin/("./cv186ah_wevb_4G.dtb");
			type = "flat_dt";
			arch = "arm64";
			compression = "none";
			hash-1 {
				algo = "sha256";
			};
			signature {
				algo = "sha256,rsa2048";
				padding = "pss";
				key-name-hint = "cfg";
			};
		};

		fdt-cv186ah_wevb_emmc_8G {
			description = "cvitek device tree - cv186ah_wevb_8G";
			data = /incbin/("./cv186ah_wevb_8G.dtb");
			type = "flat_dt";
			arch = "arm64";
			compression = "none";
			hash-1 {
				algo = "sha256";
			};
			signature {
				algo = "sha256,rsa2048";
				padding = "pss";
				key-name-hint = "cfg";
			};
		};

		fdt-cv186ah_wevb_emmc_12G {
			description = "cvitek device tree - cv186ah_wevb_12G";
			data = /incbin/("./cv186ah_wevb_12G.dtb");
			type = "flat_dt";
			arch = "arm64";
			compression = "none";
			hash-1 {
				algo = "sha256";
			};
			signature {
				algo = "sha256,rsa2048";
				padding = "pss";
				key-name-hint = "cfg";
			};
		};

		fdt-cv186ah_wevb_emmc_16G {
			description = "cvitek device tree - cv186ah_wevb_16G";
			data = /incbin/("./cv186ah_wevb_16G.dtb");
			type = "flat_dt";
			arch = "arm64";
			compression = "none";
			hash-1 {
				algo = "sha256";
			};
			signature {
				algo = "sha256,rsa2048";
				padding = "pss";
				key-name-hint = "cfg";
			};
		};

		fdt-cv186ah_nvrv1_4G {
			description = "cvitek device tree - cv186ah_nvrv1_4G";
			data = /incbin/("./cv186ah_nvrv1_4G.dtb");
			type = "flat_dt";
			arch = "arm64";
			compression = "none";
			hash-1 {
				algo = "sha256";
			};
			signature {
				algo = "sha256,rsa2048";
				padding = "pss";
				key-name-hint = "cfg";
			};
		};

		fdt-cv186ah_nvrv1_8G {
			description = "cvitek device tree - cv186ah_nvrv1_8G";
			data = /incbin/("./cv186ah_nvrv1_8G.dtb");
			type = "flat_dt";
			arch = "arm64";
			compression = "none";
			hash-1 {
				algo = "sha256";
			};
			signature {
				algo = "sha256,rsa2048";
				padding = "pss";
				key-name-hint = "cfg";
			};
		};

		fdt-cv186ah_nvrv1_12G {
			description = "cvitek device tree - cv186ah_nvrv1_12G";
			data = /incbin/("./cv186ah_nvrv1_12G.dtb");
			type = "flat_dt";
			arch = "arm64";
			compression = "none";
			hash-1 {
				algo = "sha256";
			};
			signature {
				algo = "sha256,rsa2048";
				padding = "pss";
				key-name-hint = "cfg";
			};
		};

		fdt-cv186ah_nvrv1_16G {
			description = "cvitek device tree - cv186ah_nvrv1_16G";
			data = /incbin/("./cv186ah_nvrv1_16G.dtb");
			type = "flat_dt";
			arch = "arm64";
			compression = "none";
			hash-1 {
				algo = "sha256";
			};
			signature {
				algo = "sha256,rsa2048";
				padding = "pss";
				key-name-hint = "cfg";
			};
		};

		fdt-bm1688_wevb_emmc_4G {
			description = "cvitek device tree - bm1688_wevb_4G";
			data = /incbin/("./bm1688_wevb_4G.dtb");
			type = "flat_dt";
			arch = "arm64";
			compression = "none";
			hash-1 {
				algo = "sha256";
			};
			signature {
				algo = "sha256,rsa2048";
				padding = "pss";
				key-name-hint = "cfg";
			};
		};

		fdt-bm1688_wevb_emmc_8G {
			description = "cvitek device tree - bm1688_wevb_8G";
			data = /incbin/("./bm1688_wevb_8G.dtb");
			type = "flat_dt";
			arch = "arm64";
			compression = "none";
			hash-1 {
				algo = "sha256";
			};
			signature {
				algo = "sha256,rsa2048";
				padding = "pss";
				key-name-hint = "cfg";
			};
		};

		fdt-bm1688_wevb_emmc_12G {
			description = "cvitek device tree - bm1688_wevb_12G";
			data = /incbin/("./bm1688_wevb_12G.dtb");
			type = "flat_dt";
			arch = "arm64";
			compression = "none";
			hash-1 {
				algo = "sha256";
			};
			signature {
				algo = "sha256,rsa2048";
				padding = "pss";
				key-name-hint = "cfg";
			};
		};

		fdt-bm1688_wevb_emmc_16G {
			description = "cvitek device tree - bm1688_wevb_16G";
			data = /incbin/("./bm1688_wevb_16G.dtb");
			type = "flat_dt";
			arch = "arm64";
			compression = "none";
			hash-1 {
				algo = "sha256";
			};
			signature {
				algo = "sha256,rsa2048";
				padding = "pss";
				key-name-hint = "cfg";
			};
		};

		fdt-bm1688_nvrv1_4G {
			description = "cvitek device tree - bm1688_nvrv1_4G";
			data = /incbin/("./bm1688_nvrv1_4G.dtb");
			type = "flat_dt";
			arch = "arm64";
			compression = "none";
			hash-1 {
				algo = "sha256";
			};
			signature {
				algo = "sha256,rsa2048";
				padding = "pss";
				key-name-hint = "cfg";
			};
		};

		fdt-bm1688_nvrv1_8G {
			description = "cvitek device tree - bm1688_nvrv1_8G";
			data = /incbin/("./bm1688_nvrv1_8G.dtb");
			type = "flat_dt";
			arch = "arm64";
			compression = "none";
			hash-1 {
				algo = "sha256";
			};
			signature {
				algo = "sha256,rsa2048";
				padding = "pss";
				key-name-hint = "cfg";
			};
		};

		fdt-bm1688_nvrv1_12G {
			description = "cvitek device tree - bm1688_nvrv1_12G";
			data = /incbin/("./bm1688_nvrv1_12G.dtb");
			type = "flat_dt";
			arch = "arm64";
			compression = "none";
			hash-1 {
				algo = "sha256";
			};
			signature {
				algo = "sha256,rsa2048";
				padding = "pss";
				key-name-hint = "cfg";
			};
		};

		fdt-bm1688_nvrv1_16G {
			description = "cvitek device tree - bm1688_nvrv1_16G";
			data = /incbin/("./bm1688_nvrv1_16G.dtb");
			type = "flat_dt";
			arch = "arm64";
			compression = "none";
			hash-1 {
				algo = "sha256";
			};
			signature {
				algo = "sha256,rsa2048";
				padding = "pss";
				key-name-hint = "cfg";
			};
		};

	};

	/*CFG*/
	configurations {
		default = "config-cv186ah_wevb_emmc";

		config-cv186ah_wevb_emmc {
			description = "boot cvitek system with board cv186ah_wevb_emmc";
			kernel = "kernel-1";
			fdt = "fdt-cv186ah_wevb_emmc";
			ramdisk = "ramdisk-1";
			signature {
				algo = "sha256,rsa2048";
				padding = "pss";
				key-name-hint = "cfg";
			};
		};

		config-cv186ah_wevb_4G {
			description = "boot cvitek system with board cv186ah_wevb_4G";
			kernel = "kernel-1";
			fdt = "fdt-cv186ah_wevb_emmc_4G";
			ramdisk = "ramdisk-1";
			signature {
				algo = "sha256,rsa2048";
				padding = "pss";
				key-name-hint = "cfg";
			};
		};

		config-cv186ah_wevb_8G {
			description = "boot cvitek system with board cv186ah_wevb_8G";
			kernel = "kernel-1";
			fdt = "fdt-cv186ah_wevb_emmc_8G";
			ramdisk = "ramdisk-1";
			signature {
				algo = "sha256,rsa2048";
				padding = "pss";
				key-name-hint = "cfg";
			};
		};

		config-cv186ah_wevb_12G {
			description = "boot cvitek system with board cv186ah_wevb_12G";
			kernel = "kernel-1";
			fdt = "fdt-cv186ah_wevb_emmc_12G";
			ramdisk = "ramdisk-1";
			signature {
				algo = "sha256,rsa2048";
				padding = "pss";
				key-name-hint = "cfg";
			};
		};

		config-cv186ah_wevb_16G {
			description = "boot cvitek system with board cv186ah_wevb_16G";
			kernel = "kernel-1";
			fdt = "fdt-cv186ah_wevb_emmc_16G";
			ramdisk = "ramdisk-1";
			signature {
				algo = "sha256,rsa2048";
				padding = "pss";
				key-name-hint = "cfg";
			};
		};

		config-cv186ah_nvrv1_4G {
			description = "boot cvitek system with board cv186ah_nvrv1_4G";
			kernel = "kernel-1";
			fdt = "fdt-cv186ah_nvrv1_4G";
			ramdisk = "ramdisk-1";
			signature {
				algo = "sha256,rsa2048";
				padding = "pss";
				key-name-hint = "cfg";
			};
		};

		config-cv186ah_nvrv1_8G {
			description = "boot cvitek system with board cv186ah_nvrv1_8G";
			kernel = "kernel-1";
			fdt = "fdt-cv186ah_nvrv1_8G";
			ramdisk = "ramdisk-1";
			signature {
				algo = "sha256,rsa2048";
				padding = "pss";
				key-name-hint = "cfg";
			};
		};

		config-cv186ah_nvrv1_12G {
			description = "boot cvitek system with board cv186ah_nvrv1_12G";
			kernel = "kernel-1";
			fdt = "fdt-cv186ah_nvrv1_12G";
			ramdisk = "ramdisk-1";
			signature {
				algo = "sha256,rsa2048";
				padding = "pss";
				key-name-hint = "cfg";
			};
		};

		config-cv186ah_nvrv1_16G {
			description = "boot cvitek system with board cv186ah_nvrv1_16G";
			kernel = "kernel-1";
			fdt = "fdt-cv186ah_nvrv1_16G";
			ramdisk = "ramdisk-1";
			signature {
				algo = "sha256,rsa2048";
				padding = "pss";
				key-name-hint = "cfg";
			};
		};

		config-bm1688_wevb_4G {
			description = "boot cvitek system with board bm1688_wevb_4G";
			kernel = "kernel-1";
			ramdisk = "ramdisk-1";
			fdt = "fdt-bm1688_wevb_emmc_4G";
			signature {
				algo = "sha256,rsa2048";
				padding = "pss";
				key-name-hint = "cfg";
			};
		};

		config-bm1688_wevb_8G {
			description = "boot cvitek system with board bm1688_wevb_8G";
			kernel = "kernel-1";
			ramdisk = "ramdisk-1";
			fdt = "fdt-bm1688_wevb_emmc_8G";
			signature {
				algo = "sha256,rsa2048";
				padding = "pss";
				key-name-hint = "cfg";
			};
		};

		config-bm1688_wevb_12G {
			description = "boot cvitek system with board bm1688_wevb_12G";
			kernel = "kernel-1";
			ramdisk = "ramdisk-1";
			fdt = "fdt-bm1688_wevb_emmc_12G";
			signature {
				algo = "sha256,rsa2048";
				padding = "pss";
				key-name-hint = "cfg";
			};
		};

		config-bm1688_wevb_16G {
			description = "boot cvitek system with board bm1688_wevb_16G";
			kernel = "kernel-1";
			ramdisk = "ramdisk-1";
			fdt = "fdt-bm1688_wevb_emmc_16G";
			signature {
				algo = "sha256,rsa2048";
				padding = "pss";
				key-name-hint = "cfg";
			};
		};

		config-bm1688_nvrv1_4G {
			description = "boot cvitek system with board bm1688_nvrv1_4G";
			kernel = "kernel-1";
			fdt = "fdt-bm1688_nvrv1_4G";
			ramdisk = "ramdisk-1";
			signature {
				algo = "sha256,rsa2048";
				padding = "pss";
				key-name-hint = "cfg";
			};
		};

		config-bm1688_nvrv1_8G {
			description = "boot cvitek system with board bm1688_nvrv1_8G";
			kernel = "kernel-1";
			fdt = "fdt-bm1688_nvrv1_8G";
			ramdisk = "ramdisk-1";
			signature {
				algo = "sha256,rsa2048";
				padding = "pss";
				key-name-hint = "cfg";
			};
		};

		config-bm1688_nvrv1_12G {
			description = "boot cvitek system with board bm1688_nvrv1_12G";
			kernel = "kernel-1";
			fdt = "fdt-bm1688_nvrv1_12G";
			ramdisk = "ramdisk-1";
			signature {
				algo = "sha256,rsa2048";
				padding = "pss";
				key-name-hint = "cfg";
			};
		};

		config-bm1688_nvrv1_16G {
			description = "boot cvitek system with board bm1688_nvrv1_16G";
			kernel = "kernel-1";
			fdt = "fdt-bm1688_nvrv1_16G";
			ramdisk = "ramdisk-1";
			signature {
				algo = "sha256,rsa2048";
				padding = "pss";
				key-name-hint = "cfg";
			};
		};

	};

};
```

## boards/sophon/device_fpga/u-boot/device_fpga_defconfig
```kconfig
CONFIG_ARM=y
CONFIG_TARGET_CVITEK=y
CONFIG_TARGET_CVITEK_CV186X=y
CONFIG_SYS_MALLOC_F_LEN=0x2000
CONFIG_SYS_BOOTMAPSZ=0x40000000
CONFIG_IDENT_STRING=" cvitek_sophgo"
CONFIG_ARMV8_SET_SMPEN=y
CONFIG_TARGET_CVITEK_CV186X_FPGA=y
CONFIG_DEFAULT_DEVICE_TREE="sophon_fpga"
CONFIG_DISTRO_DEFAULTS=y
CONFIG_FIT=y
# CONFIG_ARCH_FIXUP_FDT_MEMORY is not set
CONFIG_BOOTDELAY=1
# CONFIG_DISPLAY_CPUINFO is not set
# CONFIG_DISPLAY_BOARDINFO is not set
CONFIG_SYS_PROMPT="sophon# "
# CONFIG_ISO_PARTITION is not set
# CONFIG_EFI_PARTITION is not set
CONFIG_OF_CONTROL=y
CONFIG_PHYLIB=y
# CONFIG_PHY_BROADCOM is not set
CONFIG_PHY_SMSC=y
# CONFIG_PHY_FIXED is not set
CONFIG_PHY_REALTEK=y
CONFIG_PHY_MARVELL=y
CONFIG_DWC_ETH_QOS=y
CONFIG_DM_ETH=y
CONFIG_NETDEVICES=y
CONFIG_ETH_DESIGNWARE=y
CONFIG_NET_RANDOM_ETHADDR=y
CONFIG_DM=y
CONFIG_DM_MMC=y
CONFIG_MMC=y
CONFIG_MMC_SDHCI=y
CONFIG_MMC_SDHCI_SDMA=y
CONFIG_MMC_SDHCI_CVITEK=y
CONFIG_SYS_NS16550=y
CONFIG_BAUDRATE=38400
CONFIG_LZ4=y
CONFIG_LZMA=y

CONFIG_CMD_MEMTEST=y
CONFIG_CMD_UNZIP=y
CONFIG_CMD_MMC=y
CONFIG_CMD_CACHE=y
CONFIG_CMD_FAT=y
CONFIG_CMD_CVI_UPDATE=y
CONFIG_CMD_CVI_SD_UPDATE=y
CONFIG_CMD_CVI_REBOOT=y
CONFIG_CMD_NFS=y
CONFIG_CMD_PART=y

CONFIG_CMD_I2C=y
CONFIG_DM_I2C=y
CONFIG_SYS_I2C_DW=y

CONFIG_DM_GPIO=y
CONFIG_CMD_GPIO=y
CONFIG_DWAPB_GPIO=y
CONFIG_CMD_GPIO=Y
# CONFIG_CMD_CONSOLE is not set
# CONFIG_CMD_IMLS is not set
# CONFIG_CMD_XIMG is not set
# CONFIG_CMD_EDITENV is not set
# CONFIG_CMD_ENV_EXISTS is not set
# CONFIG_CMD_LOADS is not set
# CONFIG_CMD_FPGA is not set
# CONFIG_CMD_ITEST is not set
# CONFIG_CMD_MISC is not set

# CONFIG_MTD=y
# CONFIG_SPI=y
# CONFIG_SPI_FLASH=y

# CONFIG_MTD_RAW_NAND=y
# CONFIG_NAND_FLASH_CVSNFC_V3=y
# CONFIG_ENV_IS_IN_NAND=y
```
