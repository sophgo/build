## boards/sophon/bm1688_wevb_emmc/multi.its
```
/*
 * U-Boot uImage source file with multiple kernels, ramdisks and FDT blobs
 */

/dts-v1/;

/ {
	description = "Various kernels, ramdisks and FDT blobs";
	#address-cells = <2>;

	images {
		kernel-1 {
			description = "cvitek kernel";
			data = /incbin/("./Image.lzma");
			type = "kernel";
			arch = "arm64";
			os = "linux";
			compression = "lzma";
			load = <0x1 0x00200000>;
			entry = <0x1 0x00200000>;
			hash-2 {
				algo = "crc32";
			};
		};

		ramdisk-1 {
			description = "cvitek ramdisk";
			data = /incbin/("./boot.cpio.gz");
			type = "ramdisk";
			arch = "arm64";
			os = "linux";
			compression = "lzma";
			load = <00000000>;
			entry = <00000000>;
			hash-1 {
				algo = "crc32";
			};
		};

		/*FDT*/
    
        fdt-bm1688_se9v1 {
            description = "cvitek device tree - bm1688_se9v1";
            data = /incbin/("./bm1688_se9v1_4G.dtb");
            type = "flat_dt";
            arch = "arm64";
            compression = "none";
            hash-1 {
                algo = "sha256";
            };
        };

        fdt-bm1688_se9v1_8G {
            description = "cvitek device tree - bm1688_se9v1";
            data = /incbin/("./bm1688_se9v1_8G.dtb");
            type = "flat_dt";
            arch = "arm64";
            compression = "none";
            hash-1 {
                algo = "sha256";
            };
        };

        fdt-bm1688_se9v1_12G {
            description = "cvitek device tree - bm1688_se9v1";
            data = /incbin/("./bm1688_se9v1_12G.dtb");
            type = "flat_dt";
            arch = "arm64";
            compression = "none";
            hash-1 {
                algo = "sha256";
            };
        };

        fdt-bm1688_se9v1_16G {
            description = "cvitek device tree - bm1688_se9v1";
            data = /incbin/("./bm1688_se9v1_16G.dtb");
            type = "flat_dt";
            arch = "arm64";
            compression = "none";
            hash-1 {
                algo = "sha256";
            };
        };

        fdt-bm1688_sm9v1_4G {
            description = "cvitek device tree - bm1688_sm9v1";
            data = /incbin/("./bm1688_sm9v1_4G.dtb");
            type = "flat_dt";
            arch = "arm64";
            compression = "none";
            hash-1 {
                algo = "sha256";
            };
        };

        fdt-bm1688_sm9v1_8G {
            description = "cvitek device tree - bm1688_sm9v1";
            data = /incbin/("./bm1688_sm9v1_8G.dtb");
            type = "flat_dt";
            arch = "arm64";
            compression = "none";
            hash-1 {
                algo = "sha256";
            };
        };

        fdt-bm1688_sm9v1_12G {
            description = "cvitek device tree - bm1688_sm9v1";
            data = /incbin/("./bm1688_sm9v1_12G.dtb");
            type = "flat_dt";
            arch = "arm64";
            compression = "none";
            hash-1 {
                algo = "sha256";
            };
        };

        fdt-bm1688_sm9v1_16G {
            description = "cvitek device tree - bm1688_sm9v1";
            data = /incbin/("./bm1688_sm9v1_16G.dtb");
            type = "flat_dt";
            arch = "arm64";
            compression = "none";
            hash-1 {
                algo = "sha256";
            };
        };

        fdt-bm1688_wevb_emmc {
            description = "cvitek device tree - bm1688_wevb_emmc";
            data = /incbin/("./bm1688_wevb_8G.dtb");
            type = "flat_dt";
            arch = "arm64";
            compression = "none";
            hash-1 {
                algo = "sha256";
            };
        };

        fdt-bm1688_wevb_emmc_4G {
            description = "cvitek device tree - bm1688_wevb_emmc";
            data = /incbin/("./bm1688_wevb_4G.dtb");
            type = "flat_dt";
            arch = "arm64";
            compression = "none";
            hash-1 {
                algo = "sha256";
            };
        };

	};

	/*CFG*/
    configurations {
        
        config-bm1688_se9v1_4G {
            description = "boot cvitek system with board bm1688_se9v1";
            kernel = "kernel-1";
            ramdisk = "ramdisk-1";
            fdt = "fdt-bm1688_se9v1";
        };

        config-bm1688_se9v1_8G {
            description = "boot cvitek system with board bm1688_se9v1";
            kernel = "kernel-1";
            ramdisk = "ramdisk-1";
            fdt = "fdt-bm1688_se9v1_8G";
        };

	config-bm1688_se9v1_12G {
            description = "boot cvitek system with board bm1688_se9v1";
            kernel = "kernel-1";
            ramdisk = "ramdisk-1";
            fdt = "fdt-bm1688_se9v1_12G";
        };

        config-bm1688_se9v1_16G {
            description = "boot cvitek system with board bm1688_se9v1";
            kernel = "kernel-1";
            ramdisk = "ramdisk-1";
            fdt = "fdt-bm1688_se9v1_16G";
        };

        config-bm1688_sm9v1_4G {
            description = "boot cvitek system with board bm1688_sm9v1";
            kernel = "kernel-1";
            ramdisk = "ramdisk-1";
            fdt = "fdt-bm1688_sm9v1_4G";
        };

        config-bm1688_sm9v1_8G {
            description = "boot cvitek system with board bm1688_sm9v1";
            kernel = "kernel-1";
            ramdisk = "ramdisk-1";
            fdt = "fdt-bm1688_sm9v1_8G";
        };

        config-bm1688_sm9v1_12G {
            description = "boot cvitek system with board bm1688_sm9v1";
            kernel = "kernel-1";
            ramdisk = "ramdisk-1";
            fdt = "fdt-bm1688_sm9v1_12G";
        };

        config-bm1688_sm9v1_16G {
            description = "boot cvitek system with board bm1688_sm9v1";
            kernel = "kernel-1";
            ramdisk = "ramdisk-1";
            fdt = "fdt-bm1688_sm9v1_16G";
        };

        config-bm1688_wevb_8G {
            description = "boot cvitek system with board bm1688_wevb_emmc";
            kernel = "kernel-1";
            ramdisk = "ramdisk-1";
            fdt = "fdt-bm1688_wevb_emmc";
        };

        config-bm1688_wevb_4G {
            description = "boot cvitek system with board bm1688_wevb_emmc";
            kernel = "kernel-1";
            ramdisk = "ramdisk-1";
            fdt = "fdt-bm1688_wevb_emmc_4G";
        };

        /*Compatible with dts before renaming*/
        config-athena2_se9v1_1686_emmc {
            description = "boot cvitek system with board bm1688_se9v1";
            kernel = "kernel-1";
            ramdisk = "ramdisk-1";
            fdt = "fdt-bm1688_se9v1";
        };

        /*Compatible with dts before renaming*/
        config-athena2_se9v1_emmc_8G {
            description = "boot cvitek system with board bm1688_se9v1";
            kernel = "kernel-1";
            ramdisk = "ramdisk-1";
            fdt = "fdt-bm1688_se9v1_8G";
        };

        /*Compatible with dts before renaming*/
        config-athena2_wevb_emmc_4G {
            description = "boot cvitek system with board bm1688_se9v1";
            kernel = "kernel-1";
            ramdisk = "ramdisk-1";
            fdt = "fdt-bm1688_wevb_emmc_4G";
        };

        /*Compatible with dts before renaming*/
        config-athena2_wevb_1686a_emmc {
            description = "boot cvitek system with board bm1688_se9v1";
            kernel = "kernel-1";
            ramdisk = "ramdisk-1";
            fdt = "fdt-bm1688_wevb_emmc";
        };
    };

};
```

## boards/sophon/cv186ah_wevb_emmc/multi.its
```
/*
 * U-Boot uImage source file with multiple kernels, ramdisks and FDT blobs
 */

/dts-v1/;

/ {
	description = "Various kernels, FDT blobs";
	#address-cells = <2>;

	images {
		kernel-1 {
			description = "cvitek kernel";
			data = /incbin/("./Image.lzma");
			type = "kernel";
			arch = "arm64";
			os = "linux";
			compression = "lzma";
			load = <0x1 0x00200000>;
			entry = <0x1 0x00200000>;
			hash-2 {
				algo = "crc32";
			};
		};

		/*FDT*/
    
        fdt-cv186ah_wevb_emmc {
            description = "cvitek device tree - cv186ah_wevb_emmc";
            data = /incbin/("./cv186ah_wevb_emmc.dtb");
            type = "flat_dt";
            arch = "arm64";
            compression = "none";
            hash-1 {
                algo = "sha256";
            };
        };

        fdt-bm1688_nvr_8G {
            description = "cvitek device tree - bm1688_nvr_8G";
            data = /incbin/("./bm1688_nvr_8G.dtb");
            type = "flat_dt";
            arch = "arm64";
            compression = "none";
            hash-1 {
                algo = "sha256";
            };
        };
	};

	/*CFG*/
    configurations {
        
        config-cv186ah_wevb_emmc {
            description = "boot cvitek system with board cv186ah_wevb_emmc";
            kernel = "kernel-1";
            fdt = "fdt-cv186ah_wevb_emmc";
        };

        config-bm1688_nvr_8G {
            description = "boot cvitek system with board bm1688_nvr_8G";
            kernel = "kernel-1";
            fdt = "fdt-bm1688_nvr_8G";
        };
    };

};
```

## boards/sophon/cv186ah_wevb_spinor/cv186ah_wevb_spinor_defconfig
```kconfig
CONFIG_CHIP_cv186ah=y
CONFIG_BOARD_wevb_spinor=y
CONFIG_DDR_CFG_ddr_auto=y
CONFIG_ARCH="arm64"
CONFIG_CC_OPTIMIZE_FOR_SIZE=y
CONFIG_KERNEL_ENTRY_HACK=n
CONFIG_TOOLCHAIN_GLIBC_ARM64=y
CONFIG_FLASH_SIZE_SHRINK=y
CONFIG_BOOT_IMAGE_SINGLE_DTB=y
CONFIG_STORAGE_TYPE_spinor=y
CONFIG_SENSOR_GCORE_GC4653=y
CONFIG_SENSOR_SMS_SC3335=y
CONFIG_SENSOR_SMS_SC500AI=y
CONFIG_SENSOR_SONY_IMX307=y
CONFIG_SENSOR_SONY_IMX307_2L=y
CONFIG_SENSOR_SONY_IMX307_SLAVE=y
CONFIG_SENSOR_SONY_IMX327=y
CONFIG_SENSOR_SONY_IMX327_2L=y
CONFIG_SENSOR_SONY_IMX327_SLAVE=y
CONFIG_SENSOR_OV_OS04C10=y
CONFIG_SENSOR_OV_OS04E10=y
CONFIG_SENSOR_SMS_SC4336P=y
CONFIG_SENSOR_SMS_SC4336P_SLAVE=y
CONFIG_UBOOT_2021_10=y
CONFIG_KERNEL_SRC_5.10=y
CONFIG_KERNEL_LZMA=y
CONFIG_SKIP_RAMDISK=y
CONFIG_USE_4K_ERASE_SIZE_FOR_JFFS2=y
CONFIG_SENSOR_TUNING_PARAM_cv181x_src_gcore_gc4653=y
# CONFIG_ROOTFS_OVERLAYFS is not set
CONFIG_TARGET_PACKAGE_DROPBEAR=n
CONFIG_TARGET_PACKAGE_MTD-UTILS=y
CONFIG_TARGET_PACKAGE_BUSYBOX_SYSLOGD_SCRIPT=y
CONFIG_USB_OSDRV_CVITEK_GADGET=n
# CONFIG_TARGET_PACKAGE_CVITRACER is not set
# CONFIG_TARGET_PACKAGE_GDBSERVER is not set
# CONFIG_TARGET_PACKAGE_LIBCRYPTO is not set
# CONFIG_TARGET_PACKAGE_LIBZ is not set
# CONFIG_TARGET_PACKAGE_OTASERVER is not set
# CONFIG_TARGET_PACKAGE_RSYSLOG is not set
# CONFIG_TARGET_PACKAGE_CRONTABS is not set
# CONFIG_TARGET_PACKAGE_GATORD is not set

CONFIG_TARGET_PACKAGE_WIFI=y
CONFIG_CP_EXT_WIRELESS=y

CONFIG_TARGET_PACKAGE_NTP=y
```
