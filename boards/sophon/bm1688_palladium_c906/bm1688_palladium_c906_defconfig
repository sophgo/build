## boards/sophon/bm1688_palladium_c906/bm1688_palladium_c906_defconfig
```kconfig
CONFIG_CHIP_bm1688=y
CONFIG_ARCH="riscv"
CONFIG_BOARD_palladium_c906=y
CONFIG_DDR_CFG_none=y
CONFIG_CROSS_COMPILE="riscv64-unknown-linux-gnu-"
CONFIG_KERNEL_ENTRY_HACK=y
# CONFIG_KERNEL_ENTRY_HACK_ADDR_H="0x00000001"
# CONFIG_KERNEL_ENTRY_HACK_ADDR="0x04200000"
# CONFIG_C906_HART0=y
# CONFIG_C906_HART1=y
CONFIG_C906_HART2=y
CONFIG_TOOLCHAIN_GLIBC_RISCV64=y
CONFIG_BOOT_IMAGE_SINGLE_DTB=y

CONFIG_UBOOT_2021_10=y
CONFIG_KERNEL_SRC_5.10=y
CONFIG_KERNEL_LZMA=y
CONFIG_SKIP_RAMDISK=y
# CONFIG_ROOTFS_OVERLAYFS is not set
# CONFIG_TARGET_PACKAGE_CVITRACER is not set
# CONFIG_TARGET_PACKAGE_GDBSERVER is not set
# CONFIG_TARGET_PACKAGE_LIBCRYPTO is not set
# CONFIG_TARGET_PACKAGE_LIBZ is not set
# CONFIG_TARGET_PACKAGE_OTASERVER is not set
# CONFIG_TARGET_PACKAGE_RSYSLOG is not set
# CONFIG_TARGET_PACKAGE_CRONTABS is not set
# CONFIG_TARGET_PACKAGE_GATORD is not set
# CONFIG_ENABLE_FREERTOS is not set
```

## boards/sophon/bm1688_wevb_emmc/bm1688_wevb_emmc_defconfig
```kconfig
CONFIG_CHIP_bm1688=y
CONFIG_BOARD_wevb_emmc=y
CONFIG_ROOTFS_UBUNTU=y
CONFIG_DDR_CFG_ddr_auto=y
CONFIG_ARCH="arm64"
CONFIG_CC_OPTIMIZE_FOR_SIZE=y
CONFIG_KERNEL_ENTRY_HACK=n
CONFIG_TOOLCHAIN_GLIBC_ARM64=y
CONFIG_FLASH_SIZE_SHRINK=y
CONFIG_BOOT_IMAGE_SINGLE_DTB=n
CONFIG_STORAGE_TYPE_emmc=y
CONFIG_SENSOR_GCORE_GC4653=y
CONFIG_SENSOR_SMS_SC3335=y
CONFIG_SENSOR_SMS_SC500AI=y
CONFIG_SENSOR_SONY_IMX307=y
CONFIG_SENSOR_SONY_IMX307_2L=y
CONFIG_SENSOR_SONY_IMX307_SLAVE=y
CONFIG_SENSOR_SONY_IMX327=y
CONFIG_SENSOR_SONY_IMX327_2L=y
CONFIG_SENSOR_SONY_IMX327_SLAVE=y
CONFIG_SENSOR_OV_OS04C10=y
CONFIG_SENSOR_OV_OS04E10=y
CONFIG_SENSOR_SMS_SC4336P=y
CONFIG_SENSOR_SMS_SC4336P_SLAVE=y
CONFIG_SENSOR_SONY_IMX585=y
CONFIG_SENSOR_OV_OS04A10=y
CONFIG_SENSOR_OV_OS08B10=y
CONFIG_SENSOR_SONY_IMX412=y
CONFIG_SENSOR_OV_OV2736=y
CONFIG_SENSOR_PIXELPLUS_PR2100=y
CONFIG_SENSOR_LONTIUM_LT6911=y
CONFIG_UBOOT_2021_10=y
CONFIG_KERNEL_SRC_5.10=y
CONFIG_KERNEL_LZMA=y
CONFIG_SKIP_RAMDISK=n
CONFIG_USE_4K_ERASE_SIZE_FOR_JFFS2=y
CONFIG_SENSOR_TUNING_PARAM_cv181x_src_gcore_gc4653=y
# CONFIG_ROOTFS_OVERLAYFS is not set
CONFIG_TARGET_PACKAGE_DROPBEAR=y
CONFIG_TARGET_PACKAGE_MTD-UTILS=y
CONFIG_TARGET_PACKAGE_BUSYBOX_SYSLOGD_SCRIPT=y
CONFIG_USB_OSDRV_CVITEK_GADGET=n
# CONFIG_TARGET_PACKAGE_CVITRACER is not set
# CONFIG_TARGET_PACKAGE_GDBSERVER is not set
# CONFIG_TARGET_PACKAGE_LIBZ is not set
# CONFIG_TARGET_PACKAGE_OTASERVER is not set
# CONFIG_TARGET_PACKAGE_RSYSLOG is not set
# CONFIG_TARGET_PACKAGE_CRONTABS is not set
# CONFIG_TARGET_PACKAGE_GATORD is not set
CONFIG_CMD_MMC=y

CONFIG_TARGET_PACKAGE_WIFI=y
CONFIG_CP_EXT_WIRELESS=y
CONFIG_TARGET_PACKAGE_BT=y
CONFIG_TARGET_PACKAGE_OPENSSL=y
CONFIG_TARGET_PACKAGE_LIBCRYPTO=y
```
