## boards/cv190x/cv1900b_wevb_0019a_spinand/cv1900b_wevb_0019a_spinand_defconfig
```kconfig
CONFIG_CHIP_cv1900b=y
CONFIG_BOARD_wevb_0019a_spinand=y
CONFIG_DDR_CFG_ddr2_1333_x16=y
CONFIG_ARCH="riscv"
CONFIG_CROSS_COMPILE="riscv64-unknown-linux-musl-"
CONFIG_TOOLCHAIN_MUSL_RISCV64=y
CONFIG_CC_OPTIMIZE_FOR_SIZE=y
CONFIG_KERNEL_ENTRY_HACK=y
CONFIG_KERNEL_ENTRY_HACK_ADDR=0x81200000
CONFIG_FLASH_SIZE_SHRINK=y
CONFIG_NO_FB=y
CONFIG_NO_TP=y
CONFIG_DDR_64MB_SIZE=y
CONFIG_BOOT_IMAGE_SINGLE_DTB=y
CONFIG_STORAGE_TYPE_spinand=y
CONFIG_NANDFLASH_PAGESIZE=2048
CONFIG_NANDFLASH_BLOCKSIZE=131072
CONFIG_SENSOR_TUNING_PARAM_cv190x_src_cvsens_sc2331=y
CONFIG_SENSOR_CVSENS_CV2003=y
CONFIG_SENSOR_CVSENS_CV2003_1L_SLAVE=y
CONFIG_SENSOR_CVSENS_CV2003_1L_SLAVE1=y
CONFIG_SENSOR_SMS_SC3336=y
CONFIG_SENSOR_SMS_SC2331=y
CONFIG_SENSOR_SMS_SC2336=y
CONFIG_SENSOR_GCORE_GC2053=y
CONFIG_UBOOT_2021_10=y
CONFIG_UBOOT_SPL_CUSTOM=n
CONFIG_KERNEL_SRC_5.10=y
CONFIG_KERNEL_LZMA=y
CONFIG_SKIP_RAMDISK=y
CONFIG_SUSPEND=n
# CONFIG_ROOTFS_OVERLAYFS is not set
# CONFIG_TARGET_PACKAGE_CVITRACER is not set
# CONFIG_TARGET_PACKAGE_GDBSERVER is not set
# CONFIG_TARGET_PACKAGE_LIBCRYPTO is not set
# CONFIG_TARGET_PACKAGE_LIBZ is not set
# CONFIG_TARGET_PACKAGE_OTASERVER is not set
# CONFIG_TARGET_PACKAGE_RSYSLOG is not set
CONFIG_TARGET_PACKAGE_CRONTABS=y
# CONFIG_TARGET_PACKAGE_GATORD is not set
CONFIG_TARGET_PACKAGE_WIFI=y
CONFIG_TARGET_PACKAGE_DROPBEAR=y
CONFIG_TARGET_PACKAGE_NTP=y
CONFIG_DUAL_OS=n
CONFIG_ENABLE_RTT=y
CONFIG_RTOS_COMPRESS_ORIG=y
CONFIG_RTOS_BUILD_IN_FIP=y
CONFIG_DRAM_SIZE=0x04000000
CONFIG_ION_SIZE=0x01000000
CONFIG_RTOS_ION_SIZE=0x00800000

#
# Partition Configuration
#
CONFIG_FLASH_SIZE="128MB"
CONFIG_PARTITION_COUNT=7
CONFIG_PARTITION_1=y
CONFIG_PARTITION_1_LABEL="fip"
CONFIG_PARTITION_1_SIZE="2560"
CONFIG_PARTITION_1_FILE="fip_spl.bin"
CONFIG_PARTITION_1_MOUNTPOINT=""
CONFIG_PARTITION_1_TYPE=""

CONFIG_PARTITION_2=y
CONFIG_PARTITION_2_LABEL="2nd"
CONFIG_PARTITION_2_SIZE="3072"
CONFIG_PARTITION_2_FILE="yoc.bin"
CONFIG_PARTITION_2_MOUNTPOINT=""
CONFIG_PARTITION_2_TYPE=""

CONFIG_PARTITION_3=y
CONFIG_PARTITION_3_LABEL="PQ"
CONFIG_PARTITION_3_SIZE="1024"
CONFIG_PARTITION_3_FILE="pq_data.spinand"
CONFIG_PARTITION_3_MOUNTPOINT=""
CONFIG_PARTITION_3_TYPE=""

CONFIG_PARTITION_4=y
CONFIG_PARTITION_4_LABEL="BOOT"
CONFIG_PARTITION_4_SIZE="2560"
CONFIG_PARTITION_4_FILE="boot.spinand"
CONFIG_PARTITION_4_MOUNTPOINT=""
CONFIG_PARTITION_4_TYPE=""

CONFIG_PARTITION_5=y
CONFIG_PARTITION_5_LABEL="ENV"
CONFIG_PARTITION_5_SIZE="128"
CONFIG_PARTITION_5_FILE=""
CONFIG_PARTITION_5_MOUNTPOINT=""
CONFIG_PARTITION_5_TYPE=""

CONFIG_PARTITION_6=y
CONFIG_PARTITION_6_LABEL="ROOTFS"
CONFIG_PARTITION_6_SIZE=""
CONFIG_PARTITION_6_FILE="rootfs.spinand"
CONFIG_PARTITION_6_MOUNTPOINT=""
CONFIG_PARTITION_6_TYPE=""

CONFIG_PARTITION_7=y
CONFIG_PARTITION_7_LABEL="DATA"
CONFIG_PARTITION_7_SIZE="4096"
CONFIG_PARTITION_7_FILE="data.spinand"
CONFIG_PARTITION_7_MOUNTPOINT="/mnt/data"
CONFIG_PARTITION_7_TYPE="ubifs"
# end of Partition Configuration
```

## boards/cv190x/cv1901c_wevb_0018a_emmc/cv1901c_wevb_0018a_emmc_defconfig
```kconfig
CONFIG_CHIP_cv1901c=y
CONFIG_BOARD_wevb_0018a_emmc=y
CONFIG_DDR_CFG_ddr3_1866_x16=y
CONFIG_ARCH="riscv"
CONFIG_CROSS_COMPILE="riscv64-unknown-linux-musl-"
CONFIG_TOOLCHAIN_MUSL_RISCV64=y
CONFIG_CC_OPTIMIZE_FOR_SIZE=y
CONFIG_KERNEL_ENTRY_HACK=y
CONFIG_KERNEL_ENTRY_HACK_ADDR=0x81200000
CONFIG_FLASH_SIZE_SHRINK=y
CONFIG_BOOT_IMAGE_SINGLE_DTB=y
CONFIG_STORAGE_TYPE_emmc=y
CONFIG_SENSOR_GCORE_GC4653=y
CONFIG_SENSOR_SMS_SC3335=y
CONFIG_SENSOR_SMS_SC500AI=y
CONFIG_SENSOR_SMS_SC2331_1L=y
CONFIG_SENSOR_SONY_IMX307=y
CONFIG_SENSOR_SONY_IMX307_2L=y
CONFIG_SENSOR_SONY_IMX307_SLAVE=y
CONFIG_SENSOR_SONY_IMX327=y
CONFIG_SENSOR_SONY_IMX327_2L=y
CONFIG_SENSOR_SONY_IMX327_SLAVE=y
CONFIG_SENSOR_OV_OS04C10=y
CONFIG_UBOOT_2021_10=y
CONFIG_UBOOT_SPL_CUSTOM=n
CONFIG_KERNEL_SRC_5.10=y
CONFIG_KERNEL_LZMA=y
CONFIG_SKIP_RAMDISK=y
CONFIG_SUSPEND=n
# CONFIG_ROOTFS_OVERLAYFS is not set
# CONFIG_TARGET_PACKAGE_CVITRACER is not set
# CONFIG_TARGET_PACKAGE_GDBSERVER is not set
# CONFIG_TARGET_PACKAGE_LIBCRYPTO is not set
# CONFIG_TARGET_PACKAGE_LIBZ is not set
# CONFIG_TARGET_PACKAGE_OTASERVER is not set
# CONFIG_TARGET_PACKAGE_RSYSLOG is not set
# CONFIG_TARGET_PACKAGE_CRONTABS is not set
# CONFIG_TARGET_PACKAGE_GATORD is not set
CONFIG_TARGET_PACKAGE_DROPBEAR=y
CONFIG_DUAL_OS=n
CONFIG_ENABLE_RTT=y
CONFIG_RTOS_COMPRESS_ORIG=y
CONFIG_RTOS_BUILD_IN_FIP=y
CONFIG_DRAM_SIZE=0x08000000
CONFIG_ION_SIZE=0x02000000
CONFIG_RTOS_ION_SIZE=0x01C00000

#
# Partition Configuration
#
# eMMC stores fip.bin in the eMMC boot partition (handled by the burn
# tool), so the MBR partition table starts from partition 2 (mars3
# convention).
CONFIG_FLASH_SIZE="32GB"
CONFIG_PARTITION_COUNT=7

CONFIG_PARTITION_2=y
CONFIG_PARTITION_2_LABEL="2nd"
CONFIG_PARTITION_2_SIZE="3072"
CONFIG_PARTITION_2_FILE="yoc.bin"
CONFIG_PARTITION_2_MOUNTPOINT=""
CONFIG_PARTITION_2_TYPE=""

CONFIG_PARTITION_3=y
CONFIG_PARTITION_3_LABEL="PQ"
CONFIG_PARTITION_3_SIZE="1024"
CONFIG_PARTITION_3_FILE="pq_data.emmc"
CONFIG_PARTITION_3_MOUNTPOINT=""
CONFIG_PARTITION_3_TYPE=""

CONFIG_PARTITION_4=y
CONFIG_PARTITION_4_LABEL="BOOT"
CONFIG_PARTITION_4_SIZE="8192"
CONFIG_PARTITION_4_FILE="boot.emmc"
CONFIG_PARTITION_4_MOUNTPOINT=""
CONFIG_PARTITION_4_TYPE=""

CONFIG_PARTITION_5=y
CONFIG_PARTITION_5_LABEL="ENV"
CONFIG_PARTITION_5_SIZE="128"
CONFIG_PARTITION_5_FILE=""
CONFIG_PARTITION_5_MOUNTPOINT=""
CONFIG_PARTITION_5_TYPE=""

CONFIG_PARTITION_6=y
CONFIG_PARTITION_6_LABEL="ROOTFS"
CONFIG_PARTITION_6_SIZE="61440"
CONFIG_PARTITION_6_FILE="rootfs.emmc"
CONFIG_PARTITION_6_MOUNTPOINT=""
CONFIG_PARTITION_6_TYPE=""

CONFIG_PARTITION_7=y
CONFIG_PARTITION_7_LABEL="DATA"
CONFIG_PARTITION_7_SIZE="1048576"
CONFIG_PARTITION_7_FILE="data.emmc"
CONFIG_PARTITION_7_MOUNTPOINT="/mnt/data"
CONFIG_PARTITION_7_TYPE="ext4"
# end of Partition Configuration
```

## boards/cv190x/cv1901c_wevb_0018a_spinor/cv1901c_wevb_0018a_spinor_defconfig
```kconfig
CONFIG_CHIP_cv1901c=y
CONFIG_BOARD_wevb_0018a_spinor=y
CONFIG_DDR_CFG_ddr3_1866_x16=y
CONFIG_ARCH="riscv"
CONFIG_CROSS_COMPILE="riscv64-unknown-linux-musl-"
CONFIG_TOOLCHAIN_MUSL_RISCV64=y
CONFIG_CC_OPTIMIZE_FOR_SIZE=y
CONFIG_KERNEL_ENTRY_HACK=y
CONFIG_KERNEL_ENTRY_HACK_ADDR=0x81200000
CONFIG_FLASH_SIZE_SHRINK=y
CONFIG_BOOT_IMAGE_SINGLE_DTB=y
CONFIG_STORAGE_TYPE_spinor=y
CONFIG_USE_4K_ERASE_SIZE_FOR_JFFS2=y
CONFIG_SENSOR_GCORE_GC4653=y
CONFIG_SENSOR_SMS_SC3335=y
CONFIG_SENSOR_SMS_SC500AI=y
CONFIG_SENSOR_SMS_SC2331=y
CONFIG_SENSOR_SONY_IMX307=y
CONFIG_SENSOR_SONY_IMX307_2L=y
CONFIG_SENSOR_SONY_IMX307_SLAVE=y
CONFIG_SENSOR_SONY_IMX327=y
CONFIG_SENSOR_SONY_IMX327_2L=y
CONFIG_SENSOR_SONY_IMX327_SLAVE=y
CONFIG_SENSOR_OV_OS04C10=y
CONFIG_UBOOT_2021_10=y
CONFIG_UBOOT_SPL_CUSTOM=n
CONFIG_KERNEL_SRC_5.10=y
CONFIG_KERNEL_LZMA=y
CONFIG_SKIP_RAMDISK=y
CONFIG_SUSPEND=n
# CONFIG_ROOTFS_OVERLAYFS is not set
# CONFIG_TARGET_PACKAGE_CVITRACER is not set
# CONFIG_TARGET_PACKAGE_GDBSERVER is not set
# CONFIG_TARGET_PACKAGE_LIBCRYPTO is not set
# CONFIG_TARGET_PACKAGE_LIBZ is not set
# CONFIG_TARGET_PACKAGE_OTASERVER is not set
# CONFIG_TARGET_PACKAGE_RSYSLOG is not set
# CONFIG_TARGET_PACKAGE_CRONTABS is not set
# CONFIG_TARGET_PACKAGE_GATORD is not set
CONFIG_TARGET_PACKAGE_DROPBEAR=y
CONFIG_DUAL_OS=n
CONFIG_ENABLE_RTT=y
CONFIG_RTOS_COMPRESS_ORIG=y
CONFIG_RTOS_BUILD_IN_FIP=y
CONFIG_DRAM_SIZE=0x08000000
CONFIG_ION_SIZE=0x02000000
CONFIG_RTOS_ION_SIZE=0x01C00000

#
# Partition Configuration
#
CONFIG_FLASH_SIZE="8MB"
CONFIG_PARTITION_COUNT=7
CONFIG_PARTITION_1=y
CONFIG_PARTITION_1_LABEL="fip"
CONFIG_PARTITION_1_SIZE="640"
CONFIG_PARTITION_1_FILE="fip_spl.bin"
CONFIG_PARTITION_1_MOUNTPOINT=""
CONFIG_PARTITION_1_TYPE=""

CONFIG_PARTITION_2=y
CONFIG_PARTITION_2_LABEL="2nd"
CONFIG_PARTITION_2_SIZE="3072"
CONFIG_PARTITION_2_FILE="yoc.bin"
CONFIG_PARTITION_2_MOUNTPOINT=""
CONFIG_PARTITION_2_TYPE=""

CONFIG_PARTITION_3=y
CONFIG_PARTITION_3_LABEL="PQ"
CONFIG_PARTITION_3_SIZE="1024"
CONFIG_PARTITION_3_FILE="pq_data.spinor"
CONFIG_PARTITION_3_MOUNTPOINT=""
CONFIG_PARTITION_3_TYPE=""

CONFIG_PARTITION_4=y
CONFIG_PARTITION_4_LABEL="BOOT"
CONFIG_PARTITION_4_SIZE="2560"
CONFIG_PARTITION_4_FILE="boot.spinor"
CONFIG_PARTITION_4_MOUNTPOINT=""
CONFIG_PARTITION_4_TYPE=""

CONFIG_PARTITION_5=y
CONFIG_PARTITION_5_LABEL="ENV"
CONFIG_PARTITION_5_SIZE="64"
CONFIG_PARTITION_5_FILE=""
CONFIG_PARTITION_5_MOUNTPOINT=""
CONFIG_PARTITION_5_TYPE=""

CONFIG_PARTITION_6=y
CONFIG_PARTITION_6_LABEL="ROOTFS"
CONFIG_PARTITION_6_SIZE=""
CONFIG_PARTITION_6_FILE="rootfs.spinor"
CONFIG_PARTITION_6_MOUNTPOINT=""
CONFIG_PARTITION_6_TYPE=""

CONFIG_PARTITION_7=y
CONFIG_PARTITION_7_LABEL="DATA"
CONFIG_PARTITION_7_SIZE="512"
CONFIG_PARTITION_7_FILE="data.spinor"
CONFIG_PARTITION_7_MOUNTPOINT="/mnt/data"
CONFIG_PARTITION_7_TYPE="jffs2"
# end of Partition Configuration
```

## boards/cv190x/cv190x_palladium/cv190x_palladium_defconfig
```kconfig
CONFIG_CHIP_cv190x=y
CONFIG_BOARD_palladium=y
CONFIG_ARCH="riscv"
CONFIG_DDR_CFG_ddr2_1333_x16=y
CONFIG_CROSS_COMPILE="riscv64-unknown-linux-musl-"
CONFIG_TOOLCHAIN_MUSL_RISCV64=y
CONFIG_CC_OPTIMIZE_FOR_SIZE=y
CONFIG_KERNEL_ENTRY_HACK=y
CONFIG_KERNEL_ENTRY_HACK_ADDR=0x80200000
CONFIG_FLASH_SIZE_SHRINK=y
CONFIG_NO_FB=y
CONFIG_NO_TP=y
CONFIG_DDR_64MB_SIZE=y
CONFIG_BOOT_IMAGE_SINGLE_DTB=y
CONFIG_STORAGE_TYPE_spinor=y
CONFIG_SENSOR_SONY_IMX327_FPGA=y
CONFIG_MIPI_PANEL_ILI9881C=y
CONFIG_UBOOT_2021_10=y
CONFIG_UBOOT_SPL_CUSTOM=n
CONFIG_KERNEL_SRC_5.10=y
CONFIG_KERNEL_LZMA=y
CONFIG_SKIP_RAMDISK=y
CONFIG_SUSPEND=n
# CONFIG_ROOTFS_OVERLAYFS is not set
# CONFIG_TARGET_PACKAGE_GDBSERVER is not set
# CONFIG_TARGET_PACKAGE_OTASERVER is not set
# CONFIG_TARGET_PACKAGE_RSYSLOG is not set

CONFIG_DUAL_OS=n
CONFIG_ENABLE_ALIOS=n
CONFIG_DISABLE_C906L=y

CONFIG_DRAM_SIZE=0x20000000
CONFIG_ION_SIZE=0x1a80000
CONFIG_RTOS_ION_SIZE=0x00

#
# Partition Configuration
#
CONFIG_FLASH_SIZE="16MB"
CONFIG_PARTITION_COUNT=6
CONFIG_PARTITION_1=y
CONFIG_PARTITION_1_LABEL="fip"
CONFIG_PARTITION_1_SIZE="512"
CONFIG_PARTITION_1_FILE="fip.bin"
CONFIG_PARTITION_1_MOUNTPOINT=""
CONFIG_PARTITION_1_TYPE=""

CONFIG_PARTITION_3_LABEL="BOOT"
CONFIG_PARTITION_3_SIZE="3072"
CONFIG_PARTITION_3_FILE="boot.spinor"
CONFIG_PARTITION_3_MOUNTPOINT=""
CONFIG_PARTITION_3_TYPE=""

CONFIG_PARTITION_4=y
CONFIG_PARTITION_4_LABEL="ROOTFS"
CONFIG_PARTITION_4_SIZE="4288"
CONFIG_PARTITION_4_FILE="rootfs.spinor"
CONFIG_PARTITION_4_MOUNTPOINT=""
CONFIG_PARTITION_4_TYPE=""

CONFIG_PARTITION_5=y
CONFIG_PARTITION_5_LABEL="ENV"
CONFIG_PARTITION_5_SIZE="64"
CONFIG_PARTITION_5_FILE=""
CONFIG_PARTITION_5_MOUNTPOINT=""
CONFIG_PARTITION_5_TYPE=""

CONFIG_PARTITION_6=y
CONFIG_PARTITION_6_LABEL="DATA"
CONFIG_PARTITION_6_SIZE="320"
CONFIG_PARTITION_6_FILE="data.spinor"
CONFIG_PARTITION_6_MOUNTPOINT="/mnt/data"
CONFIG_PARTITION_6_TYPE="jffs2"
# end of Partition Configuration
```
