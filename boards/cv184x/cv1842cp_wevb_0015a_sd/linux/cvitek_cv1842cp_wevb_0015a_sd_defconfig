## boards/cv184x/cv1842hp_wevb_0014a_spinor/cv1842hp_wevb_0014a_spinor_defconfig
```kconfig
CONFIG_CHIP_cv1842hp=y
CONFIG_BOARD_wevb_0014a_spinor=y
CONFIG_DDR_CFG_ddr3_2133_x16=y
CONFIG_ARCH="arm"
CONFIG_CC_OPTIMIZE_FOR_SIZE=y
CONFIG_KERNEL_ENTRY_HACK=y
CONFIG_TOOLCHAIN_MUSL_ARM=y
CONFIG_FLASH_SIZE_SHRINK=y
CONFIG_BOOT_IMAGE_SINGLE_DTB=y
CONFIG_STORAGE_TYPE_spinor=y
CONFIG_SENSOR_OV_OS04A10=y
CONFIG_SENSOR_SMS_SC4336=y
CONFIG_SENSOR_SMS_SC4336P=y
CONFIG_SENSOR_SMS_SC4336P_SLAVE=y
CONFIG_SENSOR_CVSENS_CV2003=y
#CONFIG_SENSOR_GCORE_GC2053=y
#CONFIG_SENSOR_GCORE_GC2053_1L=y
#CONFIG_SENSOR_GCORE_GC2093=y
#CONFIG_SENSOR_GCORE_GC4653=y
CONFIG_SENSOR_GCORE_GC8613=y
#CONFIG_SENSOR_PIXELPLUS_PR2020=y
#CONFIG_SENSOR_SONY_IMX307=y
#CONFIG_SENSOR_SONY_IMX327=y
CONFIG_SENSOR_SONY_IMX675=y
CONFIG_UBOOT_2021_10=y
CONFIG_KERNEL_SRC_5.10=y
CONFIG_KERNEL_SRC="linux_5.10"
CONFIG_KERNEL_LZMA=y
CONFIG_SKIP_RAMDISK=y
CONFIG_USE_4K_ERASE_SIZE_FOR_JFFS2=y
CONFIG_SENSOR_TUNING_PARAM_cv184x_src_cvsens_cv2003=y
# CONFIG_ROOTFS_OVERLAYFS is not set
#CONFIG_TARGET_PACKAGE_DROPBEAR=y
# CONFIG_TARGET_PACKAGE_RSYSLOG is not set
#CONFIG_TARGET_PACKAGE_BUSYBOX_SYSLOGD_SCRIPT=y
# CONFIG_TARGET_PACKAGE_GATORD is not set
CONFIG_TARGET_PACKAGE_GDBSERVER=n
CONFIG_TARGET_PACKAGE_LIBCRYPTO=n
CONFIG_TARGET_PACKAGE_OTASERVER=n
CONFIG_TARGET_PACKAGE_CRONTABS=n
CONFIG_C096L_DMA_ENABLE=y
CONFIG_AUD_DRV_SEL=y
CONFIG_SUSPEND=n

CONFIG_DUAL_OS=y
CONFIG_ENABLE_ALIOS=y
CONFIG_RTOS_BUILD_IN_FIP=n
CONFIG_DRAM_SIZE=0x10000000
CONFIG_ION_SIZE=0x4B00000
CONFIG_RTOS_SYS_SIZE=0x400000
CONFIG_RTOS_ION_SIZE=0x6000000
#

#
# Partition Configuration
#
CONFIG_FLASH_SIZE="16MB"
CONFIG_PARTITION_COUNT=8
CONFIG_PARTITION_1=y
CONFIG_PARTITION_1_LABEL="fip"
CONFIG_PARTITION_1_SIZE="2048"
CONFIG_PARTITION_1_FILE="fip_spl.bin"
CONFIG_PARTITION_1_MOUNTPOINT=""
CONFIG_PARTITION_1_TYPE=""

CONFIG_PARTITION_2=y
CONFIG_PARTITION_2_LABEL="2nd"
CONFIG_PARTITION_2_SIZE="1024"
CONFIG_PARTITION_2_FILE="yoc.bin"
CONFIG_PARTITION_2_MOUNTPOINT=""
CONFIG_PARTITION_2_TYPE=""
CONFIG_PARTITION_3=y

CONFIG_PARTITION_3_LABEL="BOOT"
CONFIG_PARTITION_3_SIZE="3072"
CONFIG_PARTITION_3_FILE="boot.spinor"
CONFIG_PARTITION_3_MOUNTPOINT=""
CONFIG_PARTITION_3_TYPE=""

CONFIG_PARTITION_4=y
CONFIG_PARTITION_4_LABEL="MISC"
CONFIG_PARTITION_4_SIZE="128"
CONFIG_PARTITION_4_FILE="logo.jpg"
CONFIG_PARTITION_4_MOUNTPOINT=""
CONFIG_PARTITION_4_TYPE=""

CONFIG_PARTITION_5=y
CONFIG_PARTITION_5_LABEL="ENV"
CONFIG_PARTITION_5_SIZE="64"
CONFIG_PARTITION_5_FILE=""
CONFIG_PARTITION_5_MOUNTPOINT=""
CONFIG_PARTITION_5_TYPE=""

CONFIG_PARTITION_6=y
CONFIG_PARTITION_6_LABEL="ENV_BAK"
CONFIG_PARTITION_6_SIZE="64"
CONFIG_PARTITION_6_FILE=""
CONFIG_PARTITION_6_MOUNTPOINT=""
CONFIG_PARTITION_6_TYPE=""

CONFIG_PARTITION_7=y
CONFIG_PARTITION_7_LABEL="ROOTFS"
CONFIG_PARTITION_7_SIZE="7104"
CONFIG_PARTITION_7_FILE="rootfs.spinor"
CONFIG_PARTITION_7_MOUNTPOINT=""
CONFIG_PARTITION_7_TYPE=""

CONFIG_PARTITION_8=y
CONFIG_PARTITION_8_LABEL="DATA"
CONFIG_PARTITION_8_SIZE="1024"
CONFIG_PARTITION_8_FILE="data.spinor"
CONFIG_PARTITION_8_MOUNTPOINT="/mnt/data"
CONFIG_PARTITION_8_TYPE="jffs2"
# end of Partition Configuration
```

## boards/cv184x/cv184x_fpga/cv184x_fpga_defconfig
```kconfig
CONFIG_CHIP_cv184x=y
CONFIG_ARCH="arm64"
CONFIG_TOOLCHAIN_GLIBC_ARM64=y
CONFIG_BOOT_IMAGE_SINGLE_DTB=y
CONFIG_STORAGE_TYPE_spinor=y
CONFIG_SENSOR_SONY_IMX327_FPGA=y
CONFIG_MIPI_PANEL_ILI9881C=y
CONFIG_UBOOT_2021_10=y
CONFIG_KERNEL_SRC_5.10=y
# CONFIG_ROOTFS_OVERLAYFS is not set
# CONFIG_TARGET_PACKAGE_GDBSERVER is not set
# CONFIG_TARGET_PACKAGE_OTASERVER is not set
# CONFIG_TARGET_PACKAGE_RSYSLOG is not set
CONFIG_KERNEL_UNCOMPRESSED=y
CONFIG_SKIP_RAMDISK=y
CONFIG_DUAL_OS=y
CONFIG_ENABLE_ALIOS=y
CONFIG_SUSPEND=n

CONFIG_DRAM_SIZE=0x1e000000
CONFIG_ION_SIZE=0x4B00000
CONFIG_RTOS_SYS_SIZE=0x400000
CONFIG_RTOS_ION_SIZE=0x6000000
```

## boards/cv184x/cv184x_palladium/u-boot/cvitek_cv184x_palladium_defconfig
```kconfig
CONFIG_ARM=y
CONFIG_TARGET_CVITEK=y
CONFIG_TARGET_CVITEK_CV184X=y
CONFIG_SYS_MALLOC_F_LEN=0x2000
CONFIG_SYS_BOOTMAPSZ=0x40000000
CONFIG_IDENT_STRING=" cvitek_cv184x"
CONFIG_ARMV8_SET_SMPEN=y
CONFIG_TARGET_CVITEK_CV184X_PALLADIUM=y
CONFIG_DEFAULT_DEVICE_TREE="cv184x_palladium"
CONFIG_DISTRO_DEFAULTS=y
CONFIG_FIT=y
# CONFIG_ARCH_FIXUP_FDT_MEMORY is not set
CONFIG_BOOTDELAY=1
# CONFIG_DISPLAY_CPUINFO is not set
# CONFIG_DISPLAY_BOARDINFO is not set
CONFIG_SYS_PROMPT="cv184x# "
# CONFIG_ISO_PARTITION is not set
# CONFIG_EFI_PARTITION is not set
CONFIG_OF_CONTROL=y
CONFIG_PHYLIB=y
# CONFIG_PHY_BROADCOM is not set
CONFIG_PHY_SMSC=y
# CONFIG_PHY_FIXED is not set
CONFIG_DM_ETH=y
CONFIG_NETDEVICES=y
CONFIG_ETH_DESIGNWARE=y
CONFIG_NET_RANDOM_ETHADDR=y
CONFIG_DM=y
CONFIG_DM_MMC=y
CONFIG_MMC=y
CONFIG_MMC_SDHCI=y
CONFIG_MMC_SDHCI_SDMA=y
CONFIG_MMC_SDHCI_CVITEK=y
CONFIG_SYS_NS16550=y
CONFIG_LZ4=y
CONFIG_LZMA=y

CONFIG_CMD_MEMTEST=y
CONFIG_CMD_UNZIP=y
CONFIG_CMD_MMC=y
CONFIG_CMD_CACHE=y
CONFIG_CMD_FAT=y
CONFIG_CMD_CVI_UPDATE=y
CONFIG_CMD_CVI_SD_UPDATE=y
CONFIG_CMD_CVI_REBOOT=y
CONFIG_CMD_NFS=y
CONFIG_CMD_PART=y
# CONFIG_CMD_CONSOLE is not set
# CONFIG_CMD_IMLS is not set
# CONFIG_CMD_XIMG is not set
# CONFIG_CMD_EDITENV is not set
# CONFIG_CMD_ENV_EXISTS is not set
# CONFIG_CMD_LOADS is not set
# CONFIG_CMD_FPGA is not set
# CONFIG_CMD_ITEST is not set
# CONFIG_CMD_MISC is not set

CONFIG_MTD=n
CONFIG_SPI=n
CONFIG_SPI_FLASH=n
CONFIG_DM_SPI_FLASH=n
CONFIG_DM_SPI=n
CONFIG_DELAY_ENVIRONMENT=y
CONFIG_USE_DEFAULT_ENV=y
CONFIG_FIT_SIGNATURE=n
CONFIG_FIT_FULL_CHECK=n
CONFIG_TOOLS_LIBCRYPTO=n
```

## boards/cv184x/cv184x_palladium_c906/cv184x_palladium_c906_defconfig
```kconfig
CONFIG_CHIP_cv184x=y
CONFIG_ARCH="riscv"
CONFIG_BOARD_palladium_c906=y
CONFIG_DDR_CFG_none=y
CONFIG_CROSS_COMPILE="riscv64-unknown-linux-gnu-"
CONFIG_KERNEL_ENTRY_HACK=y
CONFIG_KERNEL_ENTRY_HACK_ADDR=0x81200000
CONFIG_TOOLCHAIN_GLIBC_RISCV64=y
CONFIG_BOOT_IMAGE_SINGLE_DTB=y

CONFIG_UBOOT_2021_10=y
CONFIG_KERNEL_SRC_5.10=y
CONFIG_KERNEL_LZMA=y
CONFIG_SKIP_RAMDISK=y
CONFIG_SUSPEND=n
# CONFIG_ROOTFS_OVERLAYFS is not set
# CONFIG_TARGET_PACKAGE_CVITRACER is not set
# CONFIG_TARGET_PACKAGE_GDBSERVER is not set
# CONFIG_TARGET_PACKAGE_LIBCRYPTO is not set
# CONFIG_TARGET_PACKAGE_LIBZ is not set
# CONFIG_TARGET_PACKAGE_OTASERVER is not set
# CONFIG_TARGET_PACKAGE_RSYSLOG is not set
# CONFIG_TARGET_PACKAGE_CRONTABS is not set
# CONFIG_TARGET_PACKAGE_GATORD is not set
# CONFIG_ENABLE_FREERTOS is not set
```

## boards/cv184x/cv184x_palladium_c906/u-boot/cvitek_cv184x_palladium_c906_defconfig
```kconfig
CONFIG_RISCV=y
CONFIG_SYS_MALLOC_F_LEN=0x2000
CONFIG_NR_DRAM_BANKS=1
CONFIG_DEFAULT_DEVICE_TREE="cv184x_palladium"
CONFIG_IDENT_STRING=" cvitek_cv184x"
CONFIG_ARCH_RV64I=y
CONFIG_RISCV_SMODE=y
CONFIG_TARGET_CVITEK_CV184X=y
CONFIG_CVITEK_SPI_FLASH=n
CONFIG_DISTRO_DEFAULTS=n
CONFIG_FIT=y
# CONFIG_ARCH_FIXUP_FDT_MEMORY is not set
CONFIG_BOOTDELAY=0
CONFIG_SYS_PROMPT="cv184x_c906# "
# CONFIG_CMD_CONSOLE is not set
# CONFIG_CMD_XIMG is not set
# CONFIG_CMD_EDITENV is not set
# CONFIG_CMD_CRC32 is not set
# CONFIG_CMD_LZMADEC is not set
# CONFIG_CMD_UNLZ4 is not set
# CONFIG_CMD_UNZIP is not set
# CONFIG_CMD_LOADS is not set
CONFIG_CMD_MMC=y
# CONFIG_CMD_ITEST is not set
CONFIG_CMD_CACHE=y
CONFIG_CMD_CVI_SD_UPDATE=y
# CONFIG_ISO_PARTITION is not set
# CONFIG_EFI_PARTITION is not set
CONFIG_NET_RANDOM_ETHADDR=y
CONFIG_MMC=n
CONFIG_MMC_SDHCI=n
CONFIG_MMC_SDHCI_SDMA=n
CONFIG_MMC_SDHCI_CVITEK=n
CONFIG_MTD=y
# CONFIG_PHY_SMSC is not set
CONFIG_DM_ETH=n
CONFIG_ETH_DESIGNWARE=n
CONFIG_PHY_CVITEK=n
CONFIG_SYS_NS16550=y
CONFIG_SPI=n
CONFIG_LZ4=n
CONFIG_LZMA=n
CONFIG_TOOLS_LIBCRYPTO=n
# CONFIG_SPI_FLASH_USE_4K_SECTORS is not set
```

## boards/sophon/device_buildroot/rootfs/device_buildroot_defconfig
```kconfig
BR2_aarch64=y
BR2_TOOLCHAIN_EXTERNAL=y
BR2_TOOLCHAIN_EXTERNAL_CUSTOM=y
BR2_TOOLCHAIN_EXTERNAL_DOWNLOAD=y
BR2_TOOLCHAIN_EXTERNAL_URL="https://github.com/yike2024/host-tools/releases/download/V1.0/arm-gnu-toolchain-11.3.rel1-x86_64-aarch64-none-linux-gnu.tar.gz"
BR2_TOOLCHAIN_EXTERNAL_CUSTOM_PREFIX="aarch64-none-linux-gnu"
BR2_TOOLCHAIN_EXTERNAL_GCC_11=y
BR2_TOOLCHAIN_EXTERNAL_HEADERS_4_20=y
BR2_TOOLCHAIN_EXTERNAL_CUSTOM_GLIBC=y
# BR2_TOOLCHAIN_EXTERNAL_INET_RPC is not set
BR2_TOOLCHAIN_EXTERNAL_CXX=y
BR2_TOOLCHAIN_EXTERNAL_FORTRAN=y
BR2_TOOLCHAIN_EXTERNAL_OPENMP=y
BR2_BACKUP_SITE="http://sources.buildroot.net"
BR2_CPAN_MIRROR="http://cpan.metacpan.org"
BR2_GLOBAL_PATCH_DIR="$(TOPDIR)/board/sophgo/common/patches $(TOPDIR)/board/sophgo/cv186ah_wevb_emmc/patches"
BR2_TARGET_GENERIC_HOSTNAME="soph-bm1688"
BR2_TARGET_GENERIC_ISSUE="Welcome to SOPH-BM1688"
BR2_TARGET_GENERIC_ROOT_PASSWD="sophgo"
BR2_ROOTFS_OVERLAY="$(TOPDIR)/board/sophgo/common/overlay $(TOPDIR)/board/sophgo/edge_buildroot/overlay"
BR2_ROOTFS_POST_BUILD_SCRIPT="$(TOPDIR)/board/sophgo/common/post_build.sh $(TOPDIR)/board/sophgo/edge_buildroot/post_build.sh"
BR2_PACKAGE_BUSYBOX_SHOW_OTHERS=y
BR2_PACKAGE_E2FSPROGS=y
BR2_PACKAGE_E2FSPROGS_RESIZE2FS=y
BR2_PACKAGE_QT5=y
BR2_PACKAGE_QT5BASE_GUI=y
BR2_PACKAGE_QT5BASE_WIDGETS=y
BR2_PACKAGE_PARTED=y
BR2_PACKAGE_ICU=y
BR2_PACKAGE_COLLECTD=y
BR2_PACKAGE_COLLECTD_NTPD=y
BR2_PACKAGE_NTP=y
BR2_PACKAGE_OPENSSH=y
BR2_PACKAGE_BASH=y
BR2_PACKAGE_SUDO=y
BR2_TARGET_ROOTFS_SQUASHFS=y
BR2_TARGET_ROOTFS_SQUASHFS4_XZ=y
BR2_PACKAGE_HOST_UTIL_LINUX=y
```
