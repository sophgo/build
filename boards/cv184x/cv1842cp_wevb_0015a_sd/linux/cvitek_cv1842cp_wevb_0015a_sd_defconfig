## boards/sophon/device_fastboot/linux/device_fastboot_defconfig
```kconfig
CONFIG_SYSVIPC=y
CONFIG_POSIX_MQUEUE=y
CONFIG_NO_HZ_IDLE=y
CONFIG_HIGH_RES_TIMERS=y
CONFIG_TASKSTATS=y
CONFIG_IKCONFIG=y
CONFIG_IKCONFIG_PROC=y
CONFIG_SCHED_AUTOGROUP=y
CONFIG_BLK_DEV_INITRD=y
CONFIG_BLK_DEV_RAM=y
# CONFIG_RD_BZIP2 is not set
# CONFIG_RD_LZMA is not set
# CONFIG_RD_XZ is not set
# CONFIG_RD_LZO is not set
# CONFIG_RD_LZ4 is not set
CONFIG_PROFILING=n
CONFIG_ARM_LPAE=y
# CONFIG_VDSO is not set
CONFIG_HAVE_ARM_ARCH_TIMER=y
CONFIG_OABI_COMPAT=y
CONFIG_FORCE_MAX_ZONEORDER=10
# CONFIG_ATAGS is not set
CONFIG_KEXEC=y
CONFIG_CRASH_DUMP=y
CONFIG_VFP=y
CONFIG_NEON=y
CONFIG_KERNEL_MODE_NEON=y
CONFIG_PM_DEBUG=n
CONFIG_PM_ADVANCED_DEBUG=n
CONFIG_PM_TEST_SUSPEND=n
CONFIG_SUSPEND=n
CONFIG_PM=n
CONFIG_ARCH_CVITEK=y
CONFIG_ARCH_CV186X=y
CONFIG_ARCH_CVITEK_CHIP="CV186AH"
CONFIG_ARCH_CV186X_ASIC=y

CONFIG_PERF_EVENTS=y

CONFIG_MODULES=y
CONFIG_MODULE_FORCE_LOAD=y
CONFIG_MODULE_UNLOAD=y
CONFIG_MODULE_FORCE_UNLOAD=y
CONFIG_BLOCK=y
CONFIG_BLK_DEV_BSGLIB=y
CONFIG_TRANSPARENT_HUGEPAGE=y
CONFIG_CMA=y
CONFIG_NET=m
CONFIG_PACKET=y
CONFIG_PACKET_DIAG=y
CONFIG_UNIX=y
CONFIG_INET=y
CONFIG_IP_MULTICAST=y
CONFIG_IP_PNP=y
CONFIG_NET_SCHED=y
CONFIG_DEVTMPFS=y
CONFIG_DEVTMPFS_MOUNT=y
CONFIG_DMA_CMA=y
CONFIG_MTD=y
CONFIG_MTD_CMDLINE_PARTS=n
CONFIG_MTD_BLOCK=y
# CONFIG_MTD_RAW_NAND is not set
CONFIG_MTD_NAND_PLATFORM=y
CONFIG_MTD_NAND_CVSNFC=y
# CONFIG_MTD_UBI is not set
CONFIG_MTD_UBI_BLOCK=y
CONFIG_BLK_DEV_LOOP=m
CONFIG_SCSI=m
CONFIG_BLK_DEV_SD=m
CONFIG_CHR_DEV_SG=y
# CONFIG_SATA_AHCI is not set
CONFIG_ATA=m
CONFIG_SATA_AHCI_PLATFORM=m
CONFIG_SATA_PMP=m
CONFIG_ATA_ACPI=m
CONFIG_ATA_SFF=n
# CONFIG_NET_VENDOR_ALACRITECH is not set
# CONFIG_NET_VENDOR_AMAZON is not set
# CONFIG_NET_VENDOR_AQUANTIA is not set
# CONFIG_NET_VENDOR_ARC is not set
# CONFIG_NET_VENDOR_BROADCOM is not set
# CONFIG_NET_VENDOR_CADENCE is not set
# CONFIG_NET_VENDOR_CAVIUM is not set
# CONFIG_NET_VENDOR_CIRRUS is not set
# CONFIG_NET_VENDOR_CORTINA is not set
# CONFIG_NET_VENDOR_EZCHIP is not set
# CONFIG_NET_VENDOR_FARADAY is not set
# CONFIG_NET_VENDOR_HISILICON is not set
# CONFIG_NET_VENDOR_HUAWEI is not set
# CONFIG_NET_VENDOR_INTEL is not set
# CONFIG_NET_VENDOR_MARVELL is not set
# CONFIG_NET_VENDOR_MELLANOX is not set
# CONFIG_NET_VENDOR_MICROSEMI is not set
# CONFIG_NET_VENDOR_NATSEMI is not set
# CONFIG_NET_VENDOR_NETRONOME is not set
# CONFIG_NET_VENDOR_NI is not set
# CONFIG_NET_VENDOR_QUALCOMM is not set
# CONFIG_NET_VENDOR_RENESAS is not set
# CONFIG_NET_VENDOR_ROCKER is not set
# CONFIG_NET_VENDOR_SAMSUNG is not set
# CONFIG_NET_VENDOR_SEEQ is not set
# CONFIG_NET_VENDOR_SOLARFLARE is not set
# CONFIG_NET_VENDOR_SMSC is not set
# CONFIG_NET_VENDOR_SOCIONEXT is not set
# CONFIG_DWMAC_GENERIC is not set
# CONFIG_NET_VENDOR_SYNOPSYS is not set
# CONFIG_NET_VENDOR_VIA is not set
# CONFIG_NET_VENDOR_WIZNET is not set
#CONFIG_CVITEK_PHY=n
#CONFIG_CVITEK_PHY_UAPS=y
# CONFIG_USB_NET_DRIVERS is not set
# CONFIG_WLAN_VENDOR_ADMTEK is not set
# CONFIG_WLAN_VENDOR_ATH is not set
# CONFIG_WLAN_VENDOR_ATMEL is not set
# CONFIG_WLAN_VENDOR_BROADCOM is not set
# CONFIG_WLAN_VENDOR_CISCO is not set
# CONFIG_WLAN_VENDOR_INTEL is not set
# CONFIG_WLAN_VENDOR_INTERSIL is not set
# CONFIG_WLAN_VENDOR_MARVELL is not set
# CONFIG_WLAN_VENDOR_MEDIATEK is not set
# CONFIG_WLAN_VENDOR_RALINK is not set
# CONFIG_WLAN_VENDOR_REALTEK is not set
# CONFIG_WLAN_VENDOR_RSI is not set
# CONFIG_WLAN_VENDOR_ST is not set
# CONFIG_WLAN_VENDOR_TI is not set
# CONFIG_WLAN_VENDOR_ZYDAS is not set
# CONFIG_WLAN_VENDOR_QUANTENNA is not set
CONFIG_INPUT_MOUSEDEV=n
CONFIG_INPUT_EVDEV=m
CONFIG_SERIAL_8250=y
CONFIG_SERIAL_8250_CONSOLE=y
CONFIG_SERIAL_8250_NR_UARTS=9
CONFIG_SERIAL_8250_RUNTIME_UARTS=9
CONFIG_SERIAL_8250_DW=y
CONFIG_HW_RANDOM=n
CONFIG_HW_RANDOM_CAVIUM=n
CONFIG_HW_RANDOM_DW=n
CONFIG_CVITEK_PINCTRL_CV1835=y
CONFIG_GPIOLIB=y
CONFIG_GPIO_SYSFS=y
CONFIG_GPIO_DWAPB=y
CONFIG_THERMAL=m
CONFIG_WATCHDOG=y
CONFIG_WATCHDOG_CORE=y
CONFIG_DW_WATCHDOG=y
CONFIG_INPUT_EVDEV=y
CONFIG_MMC=y
CONFIG_MMC_SDHCI=y
CONFIG_MMC_SDHCI_PLTFM=y
CONFIG_MMC_SDHCI_CVI=y
CONFIG_NEW_LEDS=y
CONFIG_LEDS_CLASS=y
CONFIG_LEDS_GPIO=y
CONFIG_LEDS_TRIGGERS=y
CONFIG_LEDS_TRIGGER_DISK=y
CONFIG_RTC_CLASS=y
CONFIG_RTC_DRV_DS1307=y
# CONFIG_RTC_NVMEM is not set
CONFIG_STAGING=y
CONFIG_ION=y
CONFIG_ION_SYSTEM_HEAP=y
CONFIG_ION_CARVEOUT_HEAP=y
CONFIG_ION_CMA_HEAP=y
CONFIG_CVI_WIFI_PIN=y
CONFIG_ANDROID=y
CONFIG_EFIVAR_FS=n
# CONFIG_GATOR is not set
CONFIG_EXT4_FS=y
CONFIG_EXT4_FS_SECURITY=y
CONFIG_EXT4_ENCRYPTION=y
CONFIG_OVERLAY_FS=y
CONFIG_MSDOS_FS=y
CONFIG_VFAT_FS=y
CONFIG_TMPFS=y
CONFIG_UBIFS_FS=y
CONFIG_SQUASHFS=y
# CONFIG_SQUASHFS_ZLIB is not set
CONFIG_SQUASHFS_XZ=y
CONFIG_NFS_FS=y
CONFIG_ROOT_NFS=y
CONFIG_XFS_FS=y
CONFIG_XFS_SUPPORT_V4=y
CONFIG_XFS_ONLINE_SCRUB=y
CONFIG_XFS_ONLINE_REPAIR=y
CONFIG_XFS_DEBUG=y
CONFIG_XFS_ASSERT_FATAL=y

CONFIG_NLS_CODEPAGE_437=y
CONFIG_NLS_CODEPAGE_850=y
CONFIG_NLS_ISO8859_1=y
CONFIG_NLS_ISO8859_2=y
CONFIG_NLS_ISO8859_3=y
CONFIG_NLS_UTF8=y
CONFIG_CRYPTO_CCM=y
CONFIG_CRYPTO_GCM=y
# CONFIG_CRYPTO_ECHAINIV is not set
CONFIG_CRYPTO_CMAC=y
CONFIG_CRYPTO_ARC4=y
# CONFIG_CRYPTO_HW is not set
CONFIG_PRINTK_TIME=y
CONFIG_DYNAMIC_DEBUG=y
CONFIG_DEBUG_INFO=n
CONFIG_MAGIC_SYSRQ=y
CONFIG_DEBUG_KERNEL=y
CONFIG_DEBUG_STACK_USAGE=y
CONFIG_SCHEDSTATS=y
CONFIG_SCHED_STACK_END_CHECK=y
CONFIG_DEBUG_SPINLOCK=y
CONFIG_DEBUG_MUTEXES=y
CONFIG_DEBUG_ATOMIC_SLEEP=y
CONFIG_DEBUG_LIST=y
CONFIG_IRQSOFF_TRACER=y
CONFIG_SCHED_TRACER=y
CONFIG_HWLAT_TRACER=y
CONFIG_STACK_TRACER=y
CONFIG_BLK_DEV_IO_TRACE=y
CONFIG_FUNCTION_PROFILER=n
CONFIG_HAVE_DYNAMIC_FTRACE=y
CONFIG_PREEMPT_TRACER=y
CONFIG_FTRACE_SYSCALLS=y
CONFIG_FUNCTION_TRACER=y
CONFIG_FTRACE=n

#AUDIO
CONFIG_SOUND=n
CONFIG_SND=n
CONFIG_SND_SOC=n
CONFIG_SND_HDA_PREALLOC_SIZE=1
#CONFIG_SND_SOC_CV182XA_CV182XAADC=y
#CONFIG_SND_SOC_CV182XA_CV182XADAC=y
CONFIG_SND_CV1835_I2S=y
#CONFIG_SND_SOC_CV182XAADC=y
#CONFIG_SND_SOC_CV182XADAC=y
# CONFIG_SND_SOC_CV182X_CV182XPDM is not set
# CONFIG_SND_SOC_CV1835PDM is not set
# CONFIG_SND_SOC_CV1835_CONCURRENT_I2S is not set
CONFIG_SND_SOC_CV1835_USE_AUDIO_PLL=n
CONFIG_CV1835_I2S_SUBSYS=y
#a2 dac/adc
CONFIG_SND_SOC_CV186XADC=n
CONFIG_SND_SOC_CV186X_CV186XADC=n
CONFIG_SND_SOC_CV186XDAC=n
CONFIG_SND_SOC_CV186X_CV186XDAC=n
#adau1372
#CONFIG_SND_SOC_CV1835_CONCURRENT_I2S=y
#CONFIG_SND_SOC_CV1835_ADAU1372=y
#CONFIG_SND_SOC_ADAU1372=y
#CONFIG_SND_SOC_ADAU_UTILS=y
#dwi2s-adau1372
#CONFIG_SND_SOC_CV186X_DWI2S=y
#CONFIG_SND_SOC_CV186X_DWU2S_ADAU1372=y

#
# Network configurations
#
CONFIG_NET=y
CONFIG_PACKET=y
CONFIG_UNIX=y
CONFIG_INET=y
CONFIG_PACKET_DIAG=y
CONFIG_NETDEVICES=m
CONFIG_ETHERNET=m
CONFIG_STMMAC_ETH=m
CONFIG_DWMAC_BITMAIN=m
CONFIG_DWMAC_CVITEK=m
CONFIG_PHYLIB=m
CONFIG_SMSC_PHY=m
CONFIG_REALTEK_PHY=m
CONFIG_STMMAC_SELFTESTS=m
# Wireless network driver
CONFIG_CFG80211=m
CONFIG_MAC80211=m
CONFIG_RTL8852BE=m
#USB network
CONFIG_USB_USBNET=m
CONFIG_USB_NET_RNDIS_WLAN=m
CONFIG_USB_NET_DRIVERS=m
CONFIG_USB_NET_CDCETHER=m

#
# sysDMA Configurations
#
CONFIG_DMADEVICES=y
CONFIG_DW_DMAC_CVITEK=y
CONFIG_CV1835_SYSDMA_REMAP=y
CONFIG_DMA_ENGINE=y
CONFIG_DMA_OF=y
CONFIG_ARM_DMA_MEM_BUFFERABLE=y
CONFIG_HAVE_DMA_CONTIGUOUS=y
CONFIG_ARCH_HAS_PHYS_TO_DMA=y
CONFIG_DMA_SHARED_BUFFER=y
CONFIG_HAS_DMA=y
CONFIG_NEED_DMA_MAP_STATE=y
CONFIG_ARCH_DMA_ADDR_T_64BIT=y
CONFIG_HAVE_GENERIC_DMA_COHERENT=y

CONFIG_PARTITION_ADVANCED=y
CONFIG_EFI_PARTITION=y

#
# I2C support
#
CONFIG_I2C=y
CONFIG_I2C_BOARDINFO=y
CONFIG_I2C_COMPAT=y
CONFIG_I2C_CHARDEV=y
CONFIG_I2C_MUX=y
CONFIG_I2C_DESIGNWARE_CORE=y
CONFIG_I2C_DESIGNWARE_PLATFORM=y

CONFIG_SPI=y
CONFIG_SPI_MASTER=y
CONFIG_SPI_DESIGNWARE=y
CONFIG_SPI_DW_DMA=n
CONFIG_SPI_DW_MMIO=y
CONFIG_SPI_SPIDEV=y

CONFIG_STRICT_DEVMEM=n
CONFIG_FB=y
CONFIG_FB_CVITEK=m
CONFIG_DEBUG_FS=y
CONFIG_THERMAL_EMULATION=y
CONFIG_CVITEK_PWM=m
#USB
CONFIG_USB_SUPPORT=m
CONFIG_USB=m

CONFIG_USB_DWC3=m
CONFIG_USB_DWC3_HOST=m
CONFIG_USB_DWC3_GADGET=m
CONFIG_USB_DWC3_DUAL_ROLE=m
CONFIG_USB_DWC3_OF_SIMPLE=m

CONFIG_USB_XHCI_HCD=m
CONFIG_USB_XHCI_PLATFORM=m

CONFIG_USB_GADGET=m
CONFIG_USB_CONFIGFS=m
CONFIG_USB_LIBCOMPOSITE=m

CONFIG_EXTCON=y
CONFIG_USB_ROLE_SWITCH=m
CONFIG_EXTCON_USB_GPIO=m

CONFIG_SCSI=m
CONFIG_BLK_DEV_SD=m
CONFIG_USB_STORAGE=m

CONFIG_VIDEO_DEV=m
CONFIG_VIDEO_V4L2=m
CONFIG_MEDIA_CAMERA_SUPPORT=m
CONFIG_MEDIA_SUPPORT=m
CONFIG_VIDEOBUF2_CORE=m
CONFIG_VIDEOBUF2_MEMOPS=m
CONFIG_VIDEOBUF2_V4L2=m
CONFIG_VIDEOBUF2_VMALLOC=m
CONFIG_USB_VIDEO_CLASS=m
CONFIG_MEDIA_USB_SUPPORT=m
CONFIG_USB_HID=m
CONFIG_USB_HIDDEV=m
CONFIG_SND_USB_AUDIO=m

CONFIG_USB_F_ACM=m
CONFIG_USB_CONFIGFS_ACM=m
CONFIG_USB_G_SERIAL=m
CONFIG_USB_U_SERIAL=m
CONFIG_USB_GSPCA=n
CONFIG_USB_CONFIGFS_F_FS=m
CONFIG_USB_F_FS=m
CONFIG_USB_CONFIGFS_F_MTP=m
CONFIG_USB_F_MTP=m
CONFIG_USB_CONFIGFS_F_UVC=m
CONFIG_USB_F_UVC=m
CONFIG_USB_CONFIGFS_RNDIS=m
CONFIG_USB_F_RNDIS=m
CONFIG_USB_ETH_RNDIS=m
CONFIG_USB_U_ETHER=m
CONFIG_USB_CONFIGFS_MASS_STORAGE=m
CONFIG_USB_F_MASS_STORAGE=m

#
# PCIE configuration
#
CONFIG_PCI=m
CONFIG_PCI_MSI=m
CONFIG_CV186X_PCIE0=m

#
# NVME Support
#
CONFIG_NVME_CORE=y
CONFIG_BLK_DEV_NVME=y

CONFIG_NET_VENDOR_REALTEK=m
CONFIG_R8169=m
CONFIG_NET_VENDOR_INTEL=m
CONFIG_IGB=m

CONFIG_CAN=n
CONFIG_CAN_DEV=n
CONFIG_CAN_SDVT_CAN=n
CONFIG_CAN_SDVT_PLATFORM=n
CONFIG_CAN_SDVT_BASIC=n

CONFIG_IIO=y
CONFIG_CVITEK_ADC=m

CONFIG_PWM=m
CONFIG_CVITEK_PWM=m

CONFIG_INPUT_KEYBOARD=y
CONFIG_KEYBOARD_GPIO=m
CONFIG_INPUT_MATRIXKMAP=y
CONFIG_CVITEK_KEYSCAN=m

CONFIG_RC_CORE=y
CONFIG_RC_DEVICES=y
CONFIG_CVITEK_IRRX=m

CONFIG_THERMAL=y
CONFIG_CV186X_THERMAL=y
CONFIG_THERMAL_EMULATION=y

CONFIG_WLAN_VENDOR_REALTEK=m
CONFIG_WLAN_VENDOR_MEDIATEK=m
CONFIG_WLAN_VENDOR_INTEL=m
CONFIG_IWLWIFI=m
CONFIG_IWLMVM=m
CONFIG_AIC_WLAN_SUPPORT=y
CONFIG_AIC8800_WLAN_SUPPORT=m
CONFIG_AIC_LOADFW_SUPPORT=m
CONFIG_RTL8822CU=m

CONFIG_USB_SERIAL=y
CONFIG_USB_SERIAL_OPTION=y
CONFIG_USB_NET_QMI_WWAN=m
CONFIG_USB_WDM=m
CONFIG_USB_NET_CDC_MBIM=m
CONFIG_USB_NET_CDC_NCM=m
CONFIG_USB_RTL8152=m
CONFIG_DEBUG_FS=y
CONFIG_RT_GROUP_SCHED=n
CONFIG_GENERIC_IRQ_DEBUGFS=y

CONFIG_BT=m
CONFIG_BT_HCIUART_RTL3WIRE=m
CONFIG_BT_HCIBTUSB_RTLBTUSB=m
CONFIG_RFKILL=m
CONFIG_BT_HCIBTUSB=m
CONFIG_BT_HCIUART_H4=m

#
# PM
#
CONFIG_SUSPEND=y
CONFIG_PM=y
CONFIG_PM_DEBUG=y
CONFIG_PM_ADVANCED_DEBUG=y
CONFIG_PM_TEST_SUSPEND=y
CONFIG_TUN=y

CONFIG_LOCALVERSION_AUTO=n
```
