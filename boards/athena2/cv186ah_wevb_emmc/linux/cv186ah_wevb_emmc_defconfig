## boards/default/u-boot/cv180x_wevb_riscv_spinor_defconfig
```kconfig
CONFIG_RISCV=y
CONFIG_SPL_LIBCOMMON_SUPPORT=y
CONFIG_SPL_LIBGENERIC_SUPPORT=y
CONFIG_SYS_MALLOC_F_LEN=0x100000
CONFIG_NR_DRAM_BANKS=1
CONFIG_DEFAULT_DEVICE_TREE="cv180x_asic"
CONFIG_SPL_TEXT_BASE=0x83700000
CONFIG_SPL_SERIAL_SUPPORT=y
CONFIG_SPL_SIZE_LIMIT=0x100000
CONFIG_SPL=y
CONFIG_IDENT_STRING=" cvitek_cv180x"
CONFIG_ARCH_RV64I=y
CONFIG_RISCV_SMODE=y
CONFIG_SPL_RISCV_SMODE=y
CONFIG_TARGET_CVITEK_CV180X=y
CONFIG_CVITEK_SPI_FLASH=y
CONFIG_DISTRO_DEFAULTS=y
CONFIG_FIT=y
# CONFIG_ARCH_FIXUP_FDT_MEMORY is not set
CONFIG_BOOTDELAY=1
CONFIG_SUPPORT_SPL=y
CONFIG_SPL_FRAMEWORK_BOARD_INIT_F=y
CONFIG_SPL_SHOW_ERRORS=y
# CONFIG_SPL_BANNER_PRINT is not set
CONFIG_SPL_MTD_SUPPORT=y
CONFIG_SPL_NOR_SUPPORT=y
CONFIG_SPL_OS_BOOT=y
CONFIG_SYS_PROMPT="cv180x_c906# "
# CONFIG_CMD_CONSOLE is not set
# CONFIG_CMD_XIMG is not set
# CONFIG_CMD_EDITENV is not set
# CONFIG_CMD_CRC32 is not set
# CONFIG_CMD_LZMADEC is not set
# CONFIG_CMD_UNLZ4 is not set
# CONFIG_CMD_UNZIP is not set
# CONFIG_CMD_LOADS is not set
CONFIG_CMD_MMC=y
# CONFIG_CMD_ITEST is not set
CONFIG_CMD_CACHE=y
# CONFIG_ISO_PARTITION is not set
# CONFIG_EFI_PARTITION is not set
CONFIG_NET_RANDOM_ETHADDR=y
CONFIG_SPL_DM=y
CONFIG_SPL_DM_SEQ_ALIAS=y
CONFIG_MMC=y
CONFIG_MMC_SDHCI=y
CONFIG_MMC_SDHCI_SDMA=y
CONFIG_MMC_SDHCI_CVITEK=y
CONFIG_MTD=y
CONFIG_PHY_CVITEK=y
CONFIG_DM_ETH=y
CONFIG_ETH_DESIGNWARE=y
CONFIG_SYS_NS16550=y
CONFIG_SPI=y
# CONFIG_BINMAN_FDT is not set
CONFIG_LZ4=y
CONFIG_LZMA=y
CONFIG_SPL_LZ4=y
CONFIG_SPL_LZMA=y
# CONFIG_TOOLS_LIBCRYPTO is not set
```

## boards/default/u-boot/cv181x_wevb_riscv_emmc_defconfig
```kconfig
CONFIG_RISCV=y
#CONFIG_SPL_LIBCOMMON_SUPPORT=y
#CONFIG_SPL_LIBGENERIC_SUPPORT=y
CONFIG_SYS_MALLOC_F_LEN=0x200000
CONFIG_NR_DRAM_BANKS=1
CONFIG_DEFAULT_DEVICE_TREE="cv181x_asic"
#CONFIG_SPL_TEXT_BASE=0x83700000
#CONFIG_SPL_SERIAL_SUPPORT=y

#CONFIG_SPL=y
CONFIG_IDENT_STRING=" cvitek_cv181x"
CONFIG_ARCH_RV64I=y
CONFIG_RISCV_SMODE=y
#CONFIG_SPL_RISCV_SMODE=y
CONFIG_TARGET_CVITEK_CV181X=y
CONFIG_DISTRO_DEFAULTS=y
CONFIG_FIT=y
# CONFIG_ARCH_FIXUP_FDT_MEMORY is not set
CONFIG_BOOTDELAY=1
#CONFIG_SUPPORT_SPL=y
#CONFIG_SPL_FRAMEWORK_BOARD_INIT_F=y
#CONFIG_SPL_SHOW_ERRORS=y
# CONFIG_SPL_BANNER_PRINT is not set
#CONFIG_SPL_MTD_SUPPORT=y
#CONFIG_SPL_NOR_SUPPORT=y
#CONFIG_SPL_OS_BOOT=y
CONFIG_SYS_PROMPT="cv181x_c906# "
# CONFIG_CMD_CONSOLE is not set
# CONFIG_CMD_XIMG is not set
# CONFIG_CMD_EDITENV is not set
# CONFIG_CMD_CRC32 is not set
# CONFIG_CMD_LZMADEC is not set
# CONFIG_CMD_UNLZ4 is not set
# CONFIG_CMD_UNZIP is not set
# CONFIG_CMD_LOADS is not set
CONFIG_CMD_MMC=y
# CONFIG_CMD_ITEST is not set
CONFIG_CMD_CACHE=y
CONFIG_CMD_CVI_SD_UPDATE=y
# CONFIG_ISO_PARTITION is not set
# CONFIG_EFI_PARTITION is not set
CONFIG_NET_RANDOM_ETHADDR=y
#CONFIG_SPL_DM=y
#CONFIG_SPL_DM_SEQ_ALIAS=y
CONFIG_MMC=y
CONFIG_MMC_SDHCI=y
CONFIG_MMC_SDHCI_SDMA=y
CONFIG_MMC_SDHCI_CVITEK=y
CONFIG_MTD=y
# CONFIG_PHY_SMSC is not set
CONFIG_DM_ETH=y
CONFIG_ETH_DESIGNWARE=y
CONFIG_PHY_CVITEK=y
CONFIG_SYS_NS16550=y
CONFIG_SPI=y
CONFIG_LZ4=y
CONFIG_LZMA=y
#CONFIG_SPL_LZ4=y
#CONFIG_SPL_LZMA=y
# CONFIG_TOOLS_LIBCRYPTO is not set
CONFIG_ENV_IS_IN_MMC=y



# for u-boot-spl
CONFIG_SPL_SIZE_LIMIT=0x100000
CONFIG_SPL_LIBCOMMON_SUPPORT=y
CONFIG_SPL_LIBGENERIC_SUPPORT=y
CONFIG_SPL=y
CONFIG_SUPPORT_SPL=y
CONFIG_SPL_SMP=n
CONFIG_SPL_BOARD_INIT=n
CONFIG_SPL_CLK=y
CONFIG_SPL_OS_BOOT=y
# CONFIG_SPL_MTD_SUPPORT=y
# CONFIG_SPL_NOR_SUPPORT=y
CONFIG_SPL_MMC_SUPPORT=y
# CONFIG_SUPPORT_EMMC_BOOT=y
CONFIG_SPL_DM=y
CONFIG_SPL_DM_MMC=y
CONFIG_SPL_FIT=y
CONFIG_SPL_LOAD_FIT=y
CONFIG_SPL_BUILD=y
CONFIG_SPL_SERIAL_SUPPORT=y
CONFIG_SPL_FRAMEWORK_BOARD_INIT_F=y
CONFIG_DEBUG_UART=n
CONFIG_SPL_OPENSBI=n
CONFIG_SPL_LZMA=y
CONFIG_SPL_LZ4=y
CONFIG_SPL_BANNER_PRINT=n
CONFIG_SPL_USE_TINY_PRINTF=n
CONFIG_SPL_RISCV_SMODE=y
CONFIG_BINMAN_FDT=n
CONFIG_SPL_OF_CONTROL=y
CONFIG_SPL_OF_PLATDATA=n
CONFIG_SPL_TIMER=y
```

## boards/default/u-boot/cv184x_wevb_arm_emmc_defconfig
```kconfig
CONFIG_ARM=y
CONFIG_SYS_MALLOC_F_LEN=0x10000
CONFIG_NR_DRAM_BANKS=1
CONFIG_DEFAULT_DEVICE_TREE="cv184x_asic"
CONFIG_IDENT_STRING=" cvitek_cv184x"
CONFIG_ARMV8_SET_SMPEN=y
CONFIG_TARGET_CVITEK_CV184X=y
CONFIG_DISTRO_DEFAULTS=y
CONFIG_FIT=y
# CONFIG_ARCH_FIXUP_FDT_MEMORY is not set
CONFIG_BOOTDELAY=0
# CONFIG_DISPLAY_CPUINFO is not set
# CONFIG_DISPLAY_BOARDINFO is not set
CONFIG_SYS_PROMPT="cv184x# "
# CONFIG_CMD_CONSOLE is not set
# CONFIG_CMD_XIMG is not set
# CONFIG_CMD_EDITENV is not set
# CONFIG_CMD_CRC32 is not set
# CONFIG_CMD_LZMADEC is not set
# CONFIG_CMD_UNLZ4 is not set
# CONFIG_CMD_UNZIP is not set
# CONFIG_CMD_LOADS is not set
CONFIG_CMD_MMC=y
# CONFIG_CMD_ITEST is not set
CONFIG_CMD_CACHE=y
CONFIG_CMD_CVI_SD_UPDATE=y
# CONFIG_ISO_PARTITION is not set
# CONFIG_EFI_PARTITION is not set
CONFIG_OF_CONTROL=y
CONFIG_NET_RANDOM_ETHADDR=y
CONFIG_DM=y
CONFIG_MMC_SDHCI=y
CONFIG_MMC_SDHCI_SDMA=y
CONFIG_MMC_SDHCI_CVITEK=y
CONFIG_MTD=y
# CONFIG_PHY_SMSC is not set
CONFIG_DM_ETH=y
CONFIG_ETH_DESIGNWARE=y
CONFIG_PHY_CVITEK=y
CONFIG_SYS_NS16550=y
CONFIG_SPI=y
CONFIG_LZ4=y
CONFIG_LZMA=y
# CONFIG_TOOLS_LIBCRYPTO is not set
CONFIG_ENV_IS_IN_MMC=y



CONFIG_SPL_LOAD_FIT=y
CONFIG_SPL_LIBCOMMON_SUPPORT=y
CONFIG_SPL_LIBGENERIC_SUPPORT=y
CONFIG_SPL_MMC_SUPPORT=y
CONFIG_SPL_SERIAL_SUPPORT=y
CONFIG_SPL_SIZE_LIMIT=0x100000
CONFIG_SPL=y
CONFIG_SUPPORT_SPL=y
CONFIG_SPL_FRAMEWORK_BOARD_INIT_F=y
# CONFIG_SPL_BANNER_PRINT is not set
CONFIG_SPL_MMC_WRITE=y
CONFIG_SPL_OS_BOOT=y
CONFIG_SPL_OF_CONTROL=y
CONFIG_SPL_DM=y
# CONFIG_SPL_USE_TINY_PRINTF is not set
CONFIG_SPL_LZ4=y
CONFIG_SPL_LZMA=y
```

## boards/sophon/bm1688_palladium/bm1688_palladium_defconfig
```kconfig
CONFIG_CHIP_bm1688=y
CONFIG_ARCH="arm64"
CONFIG_BOARD_palladium=y
CONFIG_DDR_CFG_none=y

CONFIG_STORAGE_TYPE_none=y
CONFIG_CROSS_COMPILE_KERNEL="aarch64-linux-gnu-"
CONFIG_KERNEL_ENTRY_HACK=n
CONFIG_BOOT_IMAGE_SINGLE_DTB=y
# CONFIG_ROOTFS_OVERLAYFS is not set
# CONFIG_TARGET_PACKAGE_GDBSERVER is not set
# CONFIG_TARGET_PACKAGE_NANOMSG is not set
# CONFIG_TARGET_PACKAGE_OTASERVER is not set
# CONFIG_TARGET_PACKAGE_RSYSLOG is not set
CONFIG_TOOLCHAIN_GLIBC_ARM64=y
CONFIG_UBOOT_2021_10=y
CONFIG_KERNEL_SRC_5.10=y
CONFIG_KERNEL_UNCOMPRESSED=y

#
# Sensor settings
#

#
# Sensor support list
#
CONFIG_SENSOR_SONY_IMX327_FPGA=y

#
# Panel settings
#

#
# Panel support list
#
CONFIG_MIPI_PANEL_ILI9881C=y
```
