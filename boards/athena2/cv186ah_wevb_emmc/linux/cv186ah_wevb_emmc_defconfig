## boards/cv181x/cv1811c_wevb_0006a_spinor/cv1811c_wevb_0006a_spinor_fastboot_defconfig
```kconfig
CONFIG_CHIP_cv1811c=y
CONFIG_DDR_CFG_ddr3_1866_x16=y
CONFIG_ARCH="riscv"
CONFIG_CROSS_COMPILE="riscv64-unknown-linux-musl-"
CONFIG_CC_OPTIMIZE_FOR_SIZE=y
CONFIG_KERNEL_ENTRY_HACK=y
CONFIG_KERNEL_ENTRY_HACK_ADDR="0x80200000"
CONFIG_TOOLCHAIN_MUSL_RISCV64=y
# CONFIG_BUILD_FOR_DEBUG is not set
CONFIG_FASTBOOT=y
CONFIG_FLASH_SIZE_SHRINK=y
CONFIG_NO_FB=y
CONFIG_NO_TP=y
CONFIG_BOOT_TIME_OPTIMIZATION=y
CONFIG_ROOTFS_FORMAT_OPTIMIZATION=y
CONFIG_SKIP_UBOOT=y
CONFIG_OSDRV_BUILD_IN=y
CONFIG_BOOT_IMAGE_SINGLE_DTB=y
CONFIG_OD_CLK_SEL=y
CONFIG_IMPROVE_AXI_CLK=y
CONFIG_STORAGE_TYPE_spinor=y
CONFIG_IMPROVE_BL_NOR_SPEED=y
CONFIG_SENSOR_GCORE_GC2053=y
CONFIG_SENSOR_GCORE_GC2053_1L=y
CONFIG_SENSOR_GCORE_GC2093=y
CONFIG_SENSOR_GCORE_GC4653=y
CONFIG_SENSOR_PIXELPLUS_PR2020=y
CONFIG_SENSOR_SONY_IMX307=y
CONFIG_SENSOR_SONY_IMX327=y
CONFIG_UBOOT_2021_10=y
CONFIG_UBOOT_SPL_CUSTOM=y
CONFIG_KERNEL_SRC_5.10=y
CONFIG_KERNEL_UNCOMPRESSED=y
CONFIG_SKIP_RAMDISK=y
# CONFIG_ROOTFS_OVERLAYFS is not set
CONFIG_USE_4K_ERASE_SIZE_FOR_JFFS2=y
CONFIG_ENABLE_ALIOS=y
# CONFIG_MEDIA_SUPPORT_PROC is not set
CONFIG_RTOS_INIT_MEDIA=y
CONFIG_TARGET_PACKAGE_DROPBEAR=y
# CONFIG_TARGET_PACKAGE_GDBSERVER is not set
# CONFIG_TARGET_PACKAGE_LIBCRYPTO is not set
# CONFIG_TARGET_PACKAGE_LIBZ is not set
# CONFIG_TARGET_PACKAGE_OTASERVER is not set
# CONFIG_TARGET_PACKAGE_RSYSLOG is not set
# CONFIG_TARGET_PACKAGE_CRONTABS is not set
# CONFIG_TARGET_PACKAGE_GATORD is not set
```

## boards/cv181x/cv1811h_wevb_0007a_spinand/cv1811h_wevb_0007a_spinand_fastboot_defconfig
```kconfig
CONFIG_CHIP_cv1811h=y
CONFIG_BOARD_wevb_0007a_spinand=y
CONFIG_DDR_CFG_ddr3_1866_x16=y
CONFIG_ARCH="riscv"
CONFIG_CROSS_COMPILE="riscv64-unknown-linux-musl-"
CONFIG_CC_OPTIMIZE_FOR_SIZE=y
CONFIG_KERNEL_ENTRY_HACK=y
CONFIG_KERNEL_ENTRY_HACK_ADDR="0x80200000"
CONFIG_TOOLCHAIN_MUSL_RISCV64=y
# CONFIG_BUILD_FOR_DEBUG is not set
CONFIG_FASTBOOT=y
CONFIG_FLASH_SIZE_SHRINK=y
CONFIG_NO_FB=y
CONFIG_NO_TP=y
CONFIG_BOOT_TIME_OPTIMIZATION=y
CONFIG_ROOTFS_FORMAT_OPTIMIZATION=y
# CONFIG_SKIP_UBOOT is not set
CONFIG_OSDRV_BUILD_IN=y
CONFIG_BOOT_IMAGE_SINGLE_DTB=y
# CONFIG_C906L_DMA_ENABLE is not set
CONFIG_STORAGE_TYPE_spinand=y
CONFIG_SENSOR_GCORE_GC2053=y
CONFIG_SENSOR_GCORE_GC2053_1L=y
CONFIG_SENSOR_GCORE_GC2093=y
CONFIG_SENSOR_GCORE_GC4653=y
CONFIG_SENSOR_PIXELPLUS_PR2020=y
CONFIG_SENSOR_SONY_IMX307=y
CONFIG_SENSOR_SONY_IMX327=y
CONFIG_UBOOT_2021_10=y
CONFIG_UBOOT_SPL_CUSTOM=y
CONFIG_KERNEL_SRC_5.10=y
CONFIG_KERNEL_UNCOMPRESSED=y
CONFIG_SKIP_RAMDISK=y
# CONFIG_ROOTFS_OVERLAYFS is not set
CONFIG_ENABLE_ALIOS=y
CONFIG_OD_CLK_SEL=y
CONFIG_RTOS_INIT_MEDIA=y
CONFIG_TARGET_PACKAGE_DROPBEAR=y
# CONFIG_TARGET_PACKAGE_GDBSERVER is not set
# CONFIG_TARGET_PACKAGE_LIBCRYPTO is not set
# CONFIG_TARGET_PACKAGE_LIBZ is not set
# CONFIG_TARGET_PACKAGE_OTASERVER is not set
# CONFIG_TARGET_PACKAGE_RSYSLOG is not set
# CONFIG_TARGET_PACKAGE_CRONTABS is not set
# CONFIG_TARGET_PACKAGE_GATORD is not set
```

## boards/cv181x/cv1812cp_wevb_0006a_emmc/u-boot/cvitek_cv1812cp_wevb_0006a_emmc_spl_defconfig
```kconfig
# for u-boot-spl
CONFIG_DEFAULT_DEVICE_TREE=""
CONFIG_SYS_MALLOC_F_LEN=0x200000
CONFIG_SPL_SIZE_LIMIT=0x100000
CONFIG_SPL_LIBCOMMON_SUPPORT=y
CONFIG_SPL_LIBGENERIC_SUPPORT=y
CONFIG_SPL=y
CONFIG_SUPPORT_SPL=y
CONFIG_SPL_SMP=n
CONFIG_SPL_BOARD_INIT=n
CONFIG_SPL_CLK=y
CONFIG_SPL_OS_BOOT=y
CONFIG_SPL_MMC_SUPPORT=y
CONFIG_SPL_DM=y
CONFIG_SPL_DM_MMC=y
CONFIG_SPL_FIT=y
CONFIG_SPL_LOAD_FIT=y
CONFIG_SPL_BUILD=y
CONFIG_SPL_SERIAL_SUPPORT=y
CONFIG_SPL_FRAMEWORK_BOARD_INIT_F=y
CONFIG_DEBUG_UART=n
CONFIG_SPL_OPENSBI=n
CONFIG_SPL_LZMA=y
CONFIG_SPL_LZ4=y
CONFIG_SPL_BANNER_PRINT=n
CONFIG_SPL_USE_TINY_PRINTF=n
CONFIG_SPL_RISCV_SMODE=y
CONFIG_BINMAN_FDT=n
CONFIG_SPL_OF_CONTROL=y
CONFIG_SPL_OF_PLATDATA=n
CONFIG_SPL_TIMER=y
CONFIG_SPL_SHOW_ERRORS=y
CONFIG_SPL_DM_SEQ_ALIAS=y
```

## boards/cv181x/cv1812cpa_wevb_0006a_emmc/u-boot/cvitek_cv1812cpa_wevb_0006a_emmc_defconfig
```kconfig
CONFIG_ARM=y
CONFIG_SPL_LIBCOMMON_SUPPORT=y
CONFIG_SPL_LIBGENERIC_SUPPORT=y
CONFIG_SYS_MALLOC_F_LEN=0x100000
CONFIG_NR_DRAM_BANKS=1
CONFIG_DEFAULT_DEVICE_TREE="cv181x_asic"
CONFIG_SPL_MMC_SUPPORT=y
CONFIG_SPL_SERIAL_SUPPORT=y
CONFIG_SPL_SIZE_LIMIT=0x100000
CONFIG_SPL=y
CONFIG_IDENT_STRING=" cvitek_cv181x"
CONFIG_ARMV8_SET_SMPEN=y
CONFIG_TARGET_CVITEK_CV181X=y
CONFIG_DISTRO_DEFAULTS=y
CONFIG_FIT=y
CONFIG_SPL_LOAD_FIT=y
# CONFIG_ARCH_FIXUP_FDT_MEMORY is not set
CONFIG_BOOTDELAY=0
# CONFIG_DISPLAY_CPUINFO is not set
# CONFIG_DISPLAY_BOARDINFO is not set
CONFIG_SUPPORT_SPL=y
CONFIG_SPL_FRAMEWORK_BOARD_INIT_F=y
# CONFIG_SPL_BANNER_PRINT is not set
CONFIG_SPL_MMC_WRITE=y
CONFIG_SPL_OS_BOOT=y
CONFIG_SYS_PROMPT="cv181x# "
# CONFIG_CMD_CONSOLE is not set
# CONFIG_CMD_XIMG is not set
# CONFIG_CMD_EDITENV is not set
# CONFIG_CMD_CRC32 is not set
# CONFIG_CMD_LZMADEC is not set
# CONFIG_CMD_UNLZ4 is not set
# CONFIG_CMD_UNZIP is not set
# CONFIG_CMD_LOADS is not set
CONFIG_CMD_MMC=y
# CONFIG_CMD_ITEST is not set
CONFIG_CMD_CACHE=y
# CONFIG_ISO_PARTITION is not set
# CONFIG_EFI_PARTITION is not set
CONFIG_OF_CONTROL=y
CONFIG_SPL_OF_CONTROL=y
CONFIG_ENV_IS_IN_MMC=y
CONFIG_NET_RANDOM_ETHADDR=y
CONFIG_DM=y
CONFIG_SPL_DM=y
CONFIG_MMC_SDHCI=y
CONFIG_MMC_SDHCI_SDMA=y
CONFIG_MMC_SDHCI_CVITEK=y
# CONFIG_MMC_SKIP_TUNING is not set
CONFIG_MTD=y
CONFIG_PHY_CVITEK=y
CONFIG_DM_ETH=y
CONFIG_ETH_DESIGNWARE=y
CONFIG_SYS_NS16550=y
CONFIG_SPI=y
# CONFIG_SPL_USE_TINY_PRINTF is not set
CONFIG_LZ4=y
CONFIG_LZMA=y
CONFIG_SPL_LZ4=y
CONFIG_SPL_LZMA=y
# CONFIG_TOOLS_LIBCRYPTO is not set
```

## boards/cv181x/cv1812h_wevb_0007a_spinor/cv1812h_wevb_0007a_spinor_defconfig
```kconfig
CONFIG_CHIP_cv1812h=y
CONFIG_BOARD_wevb_0007a_spinor=y
CONFIG_DDR_CFG_ddr3_1866_x16=y
CONFIG_DDR_CFG="ddr3_1866_x16"
CONFIG_ARCH="riscv"
CONFIG_CROSS_COMPILE="riscv64-unknown-linux-musl-"
CONFIG_CC_OPTIMIZE_FOR_SIZE=y
CONFIG_KERNEL_ENTRY_HACK=y
CONFIG_KERNEL_ENTRY_HACK_ADDR="0x80200000"
CONFIG_TOOLCHAIN_MUSL_RISCV64=y
CONFIG_FLASH_SIZE_SHRINK=y
# CONFIG_USB_OSDRV_CVITEK_GADGET is not set
CONFIG_BOOT_IMAGE_SINGLE_DTB=y
# Sensor support list
CONFIG_SENSOR_TUNING_PARAM_cv181x_src_gcore_gc4653=y
CONFIG_STORAGE_TYPE_spinor=y
CONFIG_SENSOR_GCORE_GC2053=y
CONFIG_SENSOR_GCORE_GC2053_1L=y
CONFIG_SENSOR_GCORE_GC2093=y
CONFIG_SENSOR_GCORE_GC4653=y
CONFIG_SENSOR_PIXELPLUS_PR2020=y
CONFIG_SENSOR_SONY_IMX307=y
CONFIG_SENSOR_SONY_IMX327=y
# Panel settings
CONFIG_MIPI_PANEL_HX8394=y
CONFIG_PANEL_TUNING_PARAM="MIPI_panel_hx8394"
# uboot options
CONFIG_UBOOT_2021_10=y
CONFIG_UBOOT_SRC="u-boot-2021.10"
# Kernel options
CONFIG_KERNEL_SRC_5.10=y
CONFIG_KERNEL_SRC="linux_5.10"
# CONFIG_KERNEL_GZIP is not set
CONFIG_KERNEL_LZMA=y
# CONFIG_KERNEL_LZ4 is not set
# CONFIG_KERNEL_UNCOMPRESSED is not set
CONFIG_KERNEL_COMPRESS="lzma"
# ROOTFS options
CONFIG_SKIP_RAMDISK=y
CONFIG_ROOTFS_OVERLAYFS=y
# Rootfs packages
CONFIG_TARGET_PACKAGE_DROPBEAR=y
CONFIG_TARGET_PACKAGE_LIBCRYPTO=y
CONFIG_TARGET_PACKAGE_OPENSSL=y
CONFIG_TARGET_PACKAGE_WIFI=y
CONFIG_TARGET_PACKAGE_NTP=y
# Rtos option
CONFIG_ENABLE_ALIOS=y
CONFIG_ENABLE_RTOS_DUMP_PRINT=y
CONFIG_DUMP_PRINT_SZ_IDX=17
```

## boards/default/linux/cv181x_emmc_riscv_fastboot_defconfig
```kconfig
# CONFIG_SWAP is not set
CONFIG_SYSVIPC=y
CONFIG_NO_HZ_IDLE=y
CONFIG_HIGH_RES_TIMERS=y
CONFIG_PREEMPT=y
CONFIG_LOG_BUF_SHIFT=15
CONFIG_CC_OPTIMIZE_FOR_SIZE=y
# CONFIG_MULTIUSER is not set
# CONFIG_SYSFS_SYSCALL is not set
# CONFIG_FHANDLE is not set
# CONFIG_BUG is not set
# CONFIG_BASE_FULL is not set
# CONFIG_EPOLL is not set
# CONFIG_SIGNALFD is not set
# CONFIG_TIMERFD is not set
# CONFIG_AIO is not set
# CONFIG_IO_URING is not set
# CONFIG_ADVISE_SYSCALLS is not set
CONFIG_KALLSYMS=n
CONFIG_EMBEDDED=y
# CONFIG_VM_EVENT_COUNTERS is not set
# CONFIG_SLUB_DEBUG is not set
CONFIG_FORCE_MAX_ZONEORDER=10
CONFIG_ARCH_CVITEK=y
CONFIG_SOC_THEAD=y
# CONFIG_RISCV_SWIOTLB is not set
CONFIG_VECTOR=y
CONFIG_VECTOR_0_7=y
# CONFIG_COMPAT is not set
# CONFIG_EFI is not set
CONFIG_ARCH_CVITEK_CHIP="cv181x"
CONFIG_ARCH_CV181X_ASIC=y
# CONFIG_SECCOMP is not set
# CONFIG_STACKPROTECTOR_STRONG is not set
CONFIG_COMPAT_32BIT_TIME=y
# CONFIG_STRICT_KERNEL_RWX is not set
CONFIG_MODULES=y
CONFIG_MODULE_FORCE_LOAD=y
CONFIG_MODULE_UNLOAD=y
# CONFIG_BLK_DEV_BSG is not set
# CONFIG_MQ_IOSCHED_DEADLINE is not set
# CONFIG_MQ_IOSCHED_KYBER is not set
# CONFIG_COREDUMP is not set
CONFIG_CMA=y
CONFIG_PACKET=y
CONFIG_UNIX=y
CONFIG_INET=y
# CONFIG_INET_DIAG is not set
# CONFIG_IPV6 is not set
CONFIG_RFKILL=n
# CONFIG_ETHTOOL_NETLINK is not set
CONFIG_UEVENT_HELPER=y
CONFIG_DEVTMPFS=y
CONFIG_DEVTMPFS_MOUNT=y
# CONFIG_ALLOW_DEV_COREDUMP is not set
CONFIG_MTD=y
CONFIG_MTD_CMDLINE_PARTS=y
# CONFIG_MTD_OF_PARTS is not set
CONFIG_MTD_BLOCK=y
# CONFIG_MTD_SPI_NOR is not set
CONFIG_NETDEVICES=y
# CONFIG_NET_CORE is not set
# CONFIG_NET_VENDOR_ALACRITECH is not set
# CONFIG_NET_VENDOR_AMAZON is not set
# CONFIG_NET_VENDOR_AQUANTIA is not set
# CONFIG_NET_VENDOR_ARC is not set
# CONFIG_NET_VENDOR_AURORA is not set
# CONFIG_NET_VENDOR_BROADCOM is not set
# CONFIG_NET_VENDOR_CADENCE is not set
# CONFIG_NET_VENDOR_CAVIUM is not set
# CONFIG_NET_VENDOR_CORTINA is not set
# CONFIG_NET_VENDOR_EZCHIP is not set
# CONFIG_NET_VENDOR_HUAWEI is not set
# CONFIG_NET_VENDOR_INTEL is not set
# CONFIG_NET_VENDOR_MARVELL is not set
# CONFIG_NET_VENDOR_MICREL is not set
# CONFIG_NET_VENDOR_MICROCHIP is not set
# CONFIG_NET_VENDOR_MICROSEMI is not set
# CONFIG_NET_VENDOR_NATSEMI is not set
# CONFIG_NET_VENDOR_NETRONOME is not set
# CONFIG_NET_VENDOR_NI is not set
# CONFIG_NET_VENDOR_QUALCOMM is not set
# CONFIG_NET_VENDOR_RENESAS is not set
# CONFIG_NET_VENDOR_ROCKER is not set
# CONFIG_NET_VENDOR_SAMSUNG is not set
# CONFIG_NET_VENDOR_SEEQ is not set
# CONFIG_NET_VENDOR_SOLARFLARE is not set
# CONFIG_NET_VENDOR_SOCIONEXT is not set
# CONFIG_DWMAC_GENERIC is not set
# CONFIG_NET_VENDOR_SYNOPSYS is not set
# CONFIG_NET_VENDOR_VIA is not set
# CONFIG_NET_VENDOR_WIZNET is not set
# CONFIG_USB_NET_DRIVERS is not set
# CONFIG_WLAN_VENDOR_ADMTEK is not set
# CONFIG_WLAN_VENDOR_ATH is not set
# CONFIG_WLAN_VENDOR_ATMEL is not set
# CONFIG_WLAN_VENDOR_BROADCOM is not set
# CONFIG_WLAN_VENDOR_CISCO is not set
# CONFIG_WLAN_VENDOR_INTEL is not set
# CONFIG_WLAN_VENDOR_INTERSIL is not set
# CONFIG_WLAN_VENDOR_MARVELL is not set
# CONFIG_WLAN_VENDOR_MEDIATEK is not set
# CONFIG_WLAN_VENDOR_MICROCHIP is not set
# CONFIG_WLAN_VENDOR_RALINK is not set
# CONFIG_WLAN_VENDOR_RSI is not set
# CONFIG_WLAN_VENDOR_ST is not set
# CONFIG_WLAN_VENDOR_TI is not set
# CONFIG_WLAN_VENDOR_ZYDAS is not set
# CONFIG_WLAN_VENDOR_QUANTENNA is not set
# CONFIG_INPUT is not set
# CONFIG_SERIO is not set
# CONFIG_VT is not set
# CONFIG_LEGACY_PTYS is not set
CONFIG_SERIAL_8250=y
CONFIG_SERIAL_8250_CONSOLE=y
CONFIG_SERIAL_8250_NR_UARTS=5
CONFIG_SERIAL_8250_RUNTIME_UARTS=5
CONFIG_SERIAL_8250_DW=y
CONFIG_HW_RANDOM=y
CONFIG_I2C=y
CONFIG_I2C_CHARDEV=y
CONFIG_I2C_MUX=y
CONFIG_I2C_DESIGNWARE_PLATFORM=y
CONFIG_SPI=y
CONFIG_PINCTRL=y
CONFIG_CVITEK_PINCTRL_CV1835=y
CONFIG_GPIOLIB=y
CONFIG_GPIO_SYSFS=y
CONFIG_GPIO_DWAPB=y
CONFIG_POWER_RESET=y
# CONFIG_HWMON is not set
CONFIG_THERMAL_NETLINK=y
CONFIG_WATCHDOG=y
CONFIG_SOUND=n
CONFIG_SND=n
# CONFIG_SND_PCM_TIMER is not set
# CONFIG_SND_SUPPORT_OLD_API is not set
# CONFIG_SND_PROC_FS is not set
# CONFIG_SND_DRIVERS is not set
CONFIG_SND_HDA_PREALLOC_SIZE=1
# CONFIG_SND_SPI is not set
# CONFIG_SND_USB is not set
CONFIG_SND_SOC=n
CONFIG_SND_SOC_CV182XA_CV182XAADC=n
CONFIG_SND_SOC_CV182XA_CV182XADAC=n
CONFIG_SND_CV1835_I2S=n
CONFIG_SND_SOC_CV182XAADC=n
CONFIG_SND_SOC_CV182XADAC=n
CONFIG_SND_SOC_CV1835_USE_AUDIO_PLL=n
CONFIG_CV1835_I2S_SUBSYS=n
CONFIG_USB_DWC2=y
CONFIG_MMC_SDHCI_PLTFM=y
CONFIG_DMADEVICES=n
CONFIG_DW_DMAC_CVITEK=n
CONFIG_RTC_CLASS=y
# CONFIG_VIRTIO_MENU is not set
CONFIG_STAGING=y
CONFIG_ION=y
CONFIG_ION_SYSTEM_HEAP=y
CONFIG_ION_CARVEOUT_HEAP=y
CONFIG_ION_CMA_HEAP=y
# CONFIG_IOMMU_SUPPORT is not set
CONFIG_CV1835_SYSDMA_REMAP=n
CONFIG_SIFIVE_PLIC=y
CONFIG_ANDROID=y
# CONFIG_FILE_LOCKING is not set
# CONFIG_DNOTIFY is not set
CONFIG_VFAT_FS=y
CONFIG_TMPFS=y
CONFIG_EXT4_FS=y
CONFIG_SQUASHFS=y
CONFIG_SQUASHFS_ZLIB=y
CONFIG_SQUASHFS_XZ=y
# CONFIG_NETWORK_FILESYSTEMS is not set
CONFIG_NLS_CODEPAGE_437=y
CONFIG_NLS_ISO8859_1=y
# CONFIG_CRYPTO_HW is not set
# CONFIG_XZ_DEC_X86 is not set
# CONFIG_XZ_DEC_POWERPC is not set
# CONFIG_XZ_DEC_IA64 is not set
# CONFIG_XZ_DEC_ARMTHUMB is not set
# CONFIG_XZ_DEC_SPARC is not set
CONFIG_DMA_CMA=n
CONFIG_CMA_SIZE_MBYTES=0
CONFIG_PRINTK_TIME=y
# CONFIG_SYMBOLIC_ERRNAME is not set
# CONFIG_ENABLE_MUST_CHECK is not set
# CONFIG_FRAME_POINTER is not set
# CONFIG_DEBUG_MISC is not set
# CONFIG_SCHED_DEBUG is not set
# CONFIG_DEBUG_PREEMPT is not set
# CONFIG_RCU_TRACE is not set
# CONFIG_FTRACE is not set
# CONFIG_RUNTIME_TESTING_MENU is not set

# early console
CONFIG_RISCV_SBI_V01=y
CONFIG_SERIAL_EARLYCON_RISCV_SBI=n

# wifi
CONFIG_RTL8188FU=n
CONFIG_PTP_1588_CLOCK=n
CONFIG_PPS=n
CONFIG_CFG80211=m
CONFIG_CFG80211_DEFAULT_PS=n
CONFIG_CFG80211_CRDA_SUPPORT=n

# net
CONFIG_NET=y
CONFIG_STMMAC_ETH=m
CONFIG_CVITEK_PHY=m
CONFIG_PHYLIB=m
CONFIG_STMMAC_PLATFORM=m
CONFIG_DWMAC_CVITEK=m
CONFIG_NET_VENDOR_GOOGLE=n
CONFIG_NET_VENDOR_MELLANOX=n
CONFIG_NET_VENDOR_PENSANDO=n
CONFIG_NET_VENDOR_XILINX=n

# mmc/sd
CONFIG_MMC=y
CONFIG_MMC_SDHCI=y
CONFIG_MMC_SDHCI_CVI=y

# usb
CONFIG_USB=m

# sysfs
CONFIG_CONFIGFS_FS=n
CONFIG_SYSFS=y

# procfs
CONFIG_PROC_FS=y
CONFIG_PROC_SYSCTL=n
CONFIG_PROC_PAGE_MONITOR=n

# thermal
CONFIG_THERMAL=n

# pwm
CONFIG_PWM=n

# others
CONFIG_XZ_DEC_ARM=n

#
# Partition Types
#
CONFIG_PARTITION_ADVANCED=y
# CONFIG_ACORN_PARTITION is not set
# CONFIG_AIX_PARTITION is not set
# CONFIG_OSF_PARTITION is not set
# CONFIG_AMIGA_PARTITION is not set
# CONFIG_ATARI_PARTITION is not set
# CONFIG_MAC_PARTITION is not set
# CONFIG_MSDOS_PARTITION is not set
# CONFIG_LDM_PARTITION is not set
# CONFIG_SGI_PARTITION is not set
# CONFIG_ULTRIX_PARTITION is not set
# CONFIG_SUN_PARTITION is not set
# CONFIG_KARMA_PARTITION is not set
# CONFIG_EFI_PARTITION is not set
# CONFIG_SYSV68_PARTITION is not set
CONFIG_CMDLINE_PARTITION=y

#
# CVITEK SoC drivers
#
# CONFIG_CV1835_SYSDMA_REMAP is not set
# CONFIG_CVI_WIFI_PIN is not set
# CONFIG_CVI_BT_PIN is not set
CONFIG_CVITEK_FASTBOOT=y
CONFIG_CV181X_SYS=y
# CONFIG_CV181X_TPU is not set
CONFIG_CV181X_IPCM=y
# CONFIG_CV181X_CLK_COOLING is not set
# CONFIG_CV181X_IVE is not set
CONFIG_IIO=y
```
